ASAP2_VERSION 1 71
/* written by xcp-lite registry */
/begin PROJECT xcp_lite ""
/begin HEADER "" VERSION "1.0" /end HEADER
/begin MODULE xcp_lite ""
/include "XCP_104.aml"
/begin MOD_COMMON "" BYTE_ORDER MSB_LAST ALIGNMENT_BYTE 1 ALIGNMENT_WORD 1 ALIGNMENT_LONG 1 ALIGNMENT_FLOAT16_IEEE 1 ALIGNMENT_FLOAT32_IEEE 1 ALIGNMENT_FLOAT64_IEEE 1 ALIGNMENT_INT64 1 /end MOD_COMMON
/begin RECORD_LAYOUT U8 FNC_VALUES 1 UBYTE ROW_DIR DIRECT /end RECORD_LAYOUT
/begin RECORD_LAYOUT S8 FNC_VALUES 1 SBYTE ROW_DIR DIRECT /end RECORD_LAYOUT
/begin RECORD_LAYOUT U16 FNC_VALUES 1 UWORD ROW_DIR DIRECT /end RECORD_LAYOUT
/begin RECORD_LAYOUT S16 FNC_VALUES 1 SWORD ROW_DIR DIRECT /end RECORD_LAYOUT
/begin RECORD_LAYOUT U32 FNC_VALUES 1 ULONG ROW_DIR DIRECT /end RECORD_LAYOUT
/begin RECORD_LAYOUT S32 FNC_VALUES 1 SLONG ROW_DIR DIRECT /end RECORD_LAYOUT
/begin RECORD_LAYOUT U64 FNC_VALUES 1 A_UINT64 ROW_DIR DIRECT /end RECORD_LAYOUT
/begin RECORD_LAYOUT S64 FNC_VALUES 1 A_UINT64 ROW_DIR DIRECT /end RECORD_LAYOUT
/begin RECORD_LAYOUT F32 FNC_VALUES 1 FLOAT32_IEEE ROW_DIR DIRECT /end RECORD_LAYOUT
/begin RECORD_LAYOUT F64 FNC_VALUES 1 FLOAT64_IEEE ROW_DIR DIRECT /end RECORD_LAYOUT
/*
/begin TYPEDEF_MEASUREMENT M_F64 "" FLOAT64_IEEE NO_COMPU_METHOD 0 0 -1e12 1e12 /end TYPEDEF_MEASUREMENT
/begin TYPEDEF_CHARACTERISTIC C_F64 "" VALUE F64 0 NO_COMPU_METHOD -1e12 1e12 /end TYPEDEF_CHARACTERISTIC
/begin TYPEDEF_MEASUREMENT M_F32 "" FLOAT32_IEEE NO_COMPU_METHOD 0 0 -1e12 1e12 /end TYPEDEF_MEASUREMENT
/begin TYPEDEF_CHARACTERISTIC C_F32 "" VALUE F32 0 NO_COMPU_METHOD -1e12 1e12 /end TYPEDEF_CHARACTERISTIC
/begin TYPEDEF_MEASUREMENT M_I64 "" A_UINT64 NO_COMPU_METHOD 0 0 -1e12 1e12 /end TYPEDEF_MEASUREMENT
/begin TYPEDEF_CHARACTERISTIC C_I64 "" VALUE S64 0 NO_COMPU_METHOD -1e12 1e12 /end TYPEDEF_CHARACTERISTIC
/begin TYPEDEF_MEASUREMENT M_I32 "" SLONG NO_COMPU_METHOD 0 0 -2147483648 2147483647 /end TYPEDEF_MEASUREMENT
/begin TYPEDEF_CHARACTERISTIC C_I32 "" VALUE S32 0 NO_COMPU_METHOD -2147483648 2147483647 /end TYPEDEF_CHARACTERISTIC
/begin TYPEDEF_MEASUREMENT M_I16 "" SWORD NO_COMPU_METHOD 0 0 -32768 32767 /end TYPEDEF_MEASUREMENT
/begin TYPEDEF_CHARACTERISTIC C_I16 "" VALUE S16 0 NO_COMPU_METHOD -32768 32767 /end TYPEDEF_CHARACTERISTIC
/begin TYPEDEF_MEASUREMENT M_I8 "" SBYTE NO_COMPU_METHOD 0 0 -128 127 /end TYPEDEF_MEASUREMENT
/begin TYPEDEF_CHARACTERISTIC C_I8 "" VALUE S8 0 NO_COMPU_METHOD -128 127 /end TYPEDEF_CHARACTERISTIC
/begin TYPEDEF_MEASUREMENT M_U8 "" UBYTE NO_COMPU_METHOD 0 0 0 255 /end TYPEDEF_MEASUREMENT
/begin TYPEDEF_CHARACTERISTIC C_U8 "" VALUE U8 0 NO_COMPU_METHOD 0 255 /end TYPEDEF_CHARACTERISTIC
/begin TYPEDEF_MEASUREMENT M_U16 "" UWORD NO_COMPU_METHOD 0 0 0 65535 /end TYPEDEF_MEASUREMENT
/begin TYPEDEF_CHARACTERISTIC C_U16 "" VALUE U16 0 NO_COMPU_METHOD 0 65535 /end TYPEDEF_CHARACTERISTIC
/begin TYPEDEF_MEASUREMENT M_U32 "" ULONG NO_COMPU_METHOD 0 0 0 4294967295 /end TYPEDEF_MEASUREMENT
/begin TYPEDEF_CHARACTERISTIC C_U32 "" VALUE U32 0 NO_COMPU_METHOD 0 4294967295 /end TYPEDEF_CHARACTERISTIC
/begin TYPEDEF_MEASUREMENT M_U64 "" A_UINT64 NO_COMPU_METHOD 0 0 0 1e12 /end TYPEDEF_MEASUREMENT
/begin TYPEDEF_CHARACTERISTIC C_U64 "" VALUE U64 0 NO_COMPU_METHOD 0 1e12 /end TYPEDEF_CHARACTERISTIC
*/
/begin MOD_PAR "" EPK "2025-02-10 11:11:18Z" ADDR_EPK 0x80000000 /begin MEMORY_SEGMENT epk "" DATA FLASH INTERN 0x80000000 20 -1 -1 -1 -1 -1 /end MEMORY_SEGMENT
 /begin MEMORY_SEGMENT CalPage "" DATA FLASH INTERN 0x80010000 8 -1 -1 -1 -1 -1
  /begin IF_DATA XCP
   /begin SEGMENT 1 2 0 0 0 /begin CHECKSUM XCP_ADD_44 MAX_BLOCK_SIZE 0xFFFF EXTERNAL_FUNCTION "" /end CHECKSUM
    /begin PAGE 0x0 ECU_ACCESS_DONT_CARE XCP_READ_ACCESS_DONT_CARE XCP_WRITE_ACCESS_DONT_CARE /end PAGE
    /begin PAGE 0x1 ECU_ACCESS_DONT_CARE XCP_READ_ACCESS_DONT_CARE XCP_WRITE_ACCESS_NOT_ALLOWED /end PAGE
   /end SEGMENT
  /end IF_DATA
 /end MEMORY_SEGMENT
 /begin MEMORY_SEGMENT CalPage1 "" DATA FLASH INTERN 0x80020000 144 -1 -1 -1 -1 -1
  /begin IF_DATA XCP
   /begin SEGMENT 2 2 0 0 0 /begin CHECKSUM XCP_ADD_44 MAX_BLOCK_SIZE 0xFFFF EXTERNAL_FUNCTION "" /end CHECKSUM
    /begin PAGE 0x0 ECU_ACCESS_DONT_CARE XCP_READ_ACCESS_DONT_CARE XCP_WRITE_ACCESS_DONT_CARE /end PAGE
    /begin PAGE 0x1 ECU_ACCESS_DONT_CARE XCP_READ_ACCESS_DONT_CARE XCP_WRITE_ACCESS_NOT_ALLOWED /end PAGE
   /end SEGMENT
  /end IF_DATA
 /end MEMORY_SEGMENT
 /begin MEMORY_SEGMENT CalPage2 "" DATA FLASH INTERN 0x80030000 216 -1 -1 -1 -1 -1
  /begin IF_DATA XCP
   /begin SEGMENT 3 2 0 0 0 /begin CHECKSUM XCP_ADD_44 MAX_BLOCK_SIZE 0xFFFF EXTERNAL_FUNCTION "" /end CHECKSUM
    /begin PAGE 0x0 ECU_ACCESS_DONT_CARE XCP_READ_ACCESS_DONT_CARE XCP_WRITE_ACCESS_DONT_CARE /end PAGE
    /begin PAGE 0x1 ECU_ACCESS_DONT_CARE XCP_READ_ACCESS_DONT_CARE XCP_WRITE_ACCESS_NOT_ALLOWED /end PAGE
   /end SEGMENT
  /end IF_DATA
 /end MEMORY_SEGMENT
/end MOD_PAR
/begin IF_DATA XCP
 /begin PROTOCOL_LAYER 0x104 1000 2000 0 0 0 0 0 252 1468 BYTE_ORDER_MSB_LAST ADDRESS_GRANULARITY_BYTE OPTIONAL_CMD GET_COMM_MODE_INFO OPTIONAL_CMD GET_ID OPTIONAL_CMD SET_REQUEST OPTIONAL_CMD SET_MTA OPTIONAL_CMD UPLOAD OPTIONAL_CMD SHORT_UPLOAD OPTIONAL_CMD DOWNLOAD OPTIONAL_CMD SHORT_DOWNLOAD OPTIONAL_CMD GET_CAL_PAGE OPTIONAL_CMD SET_CAL_PAGE OPTIONAL_CMD COPY_CAL_PAGE OPTIONAL_CMD BUILD_CHECKSUM OPTIONAL_CMD GET_DAQ_RESOLUTION_INFO OPTIONAL_CMD GET_DAQ_PROCESSOR_INFO OPTIONAL_CMD FREE_DAQ OPTIONAL_CMD ALLOC_DAQ OPTIONAL_CMD ALLOC_ODT OPTIONAL_CMD ALLOC_ODT_ENTRY OPTIONAL_CMD SET_DAQ_PTR OPTIONAL_CMD WRITE_DAQ OPTIONAL_CMD GET_DAQ_LIST_MODE OPTIONAL_CMD SET_DAQ_LIST_MODE OPTIONAL_CMD START_STOP_SYNCH OPTIONAL_CMD START_STOP_DAQ_LIST OPTIONAL_CMD GET_DAQ_CLOCK OPTIONAL_CMD WRITE_DAQ_MULTIPLE OPTIONAL_CMD TIME_CORRELATION_PROPERTIES OPTIONAL_CMD USER_CMD OPTIONAL_LEVEL1_CMD GET_VERSION /end PROTOCOL_LAYER
 /begin DAQ DYNAMIC 0 16 0 OPTIMISATION_TYPE_DEFAULT ADDRESS_EXTENSION_FREE IDENTIFICATION_FIELD_TYPE_RELATIVE_BYTE GRANULARITY_ODT_ENTRY_SIZE_DAQ_BYTE 0xF8 OVERLOAD_INDICATION_PID /begin TIMESTAMP_SUPPORTED 0x1 SIZE_DWORD UNIT_1US TIMESTAMP_FIXED /end TIMESTAMP_SUPPORTED /begin EVENT "mainloop" "mainloop" 0 DAQ 0xFF 0 0 0 CONSISTENCY DAQ /end EVENT
  /begin EVENT "mainloop_local" "mainloop" 1 DAQ 0xFF 0 0 0 CONSISTENCY DAQ /end EVENT
  /begin EVENT "mainloop_map" "mainloop" 2 DAQ 0xFF 0 0 0 CONSISTENCY DAQ /end EVENT
  /begin EVENT "static_event" "static_e" 3 DAQ 0xFF 0 0 0 CONSISTENCY DAQ /end EVENT
  /begin EVENT "task1" "task1" 4 DAQ 0xFF 0 0 0 CONSISTENCY DAQ /end EVENT
  /begin EVENT "task2_inst_1" "task2__1" 5 DAQ 0xFF 0 0 0 CONSISTENCY DAQ /end EVENT
  /begin EVENT "task2_inst_2" "task2__2" 6 DAQ 0xFF 0 0 0 CONSISTENCY DAQ /end EVENT
  /begin EVENT "task2_inst_3" "task2__3" 7 DAQ 0xFF 0 0 0 CONSISTENCY DAQ /end EVENT
  /begin EVENT "task2_inst_4" "task2__4" 8 DAQ 0xFF 0 0 0 CONSISTENCY DAQ /end EVENT
  /begin EVENT "task2_inst_5" "task2__5" 9 DAQ 0xFF 0 0 0 CONSISTENCY DAQ /end EVENT
  /begin EVENT "task2_inst_6" "task2__6" 10 DAQ 0xFF 0 0 0 CONSISTENCY DAQ /end EVENT
  /begin EVENT "task2_inst_7" "task2__7" 11 DAQ 0xFF 0 0 0 CONSISTENCY DAQ /end EVENT
  /begin EVENT "task2_inst_8" "task2__8" 12 DAQ 0xFF 0 0 0 CONSISTENCY DAQ /end EVENT
  /begin EVENT "task2_inst_9" "task2__9" 13 DAQ 0xFF 0 0 0 CONSISTENCY DAQ /end EVENT
  /begin EVENT "task2_inst_10" "task2__10" 14 DAQ 0xFF 0 0 0 CONSISTENCY DAQ /end EVENT
  /begin EVENT "task2_static" "task2_st" 15 DAQ 0xFF 0 0 0 CONSISTENCY DAQ /end EVENT
 /end DAQ
 /begin XCP_ON_UDP_IP 0x104 5555 ADDRESS "192.168.0.83" /end XCP_ON_UDP_IP
/end IF_DATA
/begin MEASUREMENT array1 "" FLOAT64_IEEE NO_COMPU_METHOD 0 0 -1E15 1E15 PHYS_UNIT "" ECU_ADDRESS 0x4F7F4 ECU_ADDRESS_EXTENSION 2 MATRIX_DIM 256
 /begin IF_DATA XCP
  /begin DAQ_EVENT FIXED_EVENT_LIST EVENT 4 /end DAQ_EVENT
 /end IF_DATA
/end MEASUREMENT
/begin COMPU_METHOD channel.Conv "" LINEAR "%6.3" "Volt" COEFFS_LINEAR 1 0 /end COMPU_METHOD
/begin MEASUREMENT channel "sine: f64" FLOAT64_IEEE channel.Conv 0 0 -1E15 1E15 ECU_ADDRESS 0xF0000 ECU_ADDRESS_EXTENSION 2
 /begin IF_DATA XCP
  /begin DAQ_EVENT FIXED_EVENT_LIST EVENT 15 /end DAQ_EVENT
 /end IF_DATA
/end MEASUREMENT
/begin COMPU_METHOD channel_1.Conv "" LINEAR "%6.3" "Volt" COEFFS_LINEAR 1 0 /end COMPU_METHOD
/begin MEASUREMENT channel_1 "sine: f64" FLOAT64_IEEE channel_1.Conv 0 0 -1E15 1E15 ECU_ADDRESS 0x50000 ECU_ADDRESS_EXTENSION 2
 /begin IF_DATA XCP
  /begin DAQ_EVENT FIXED_EVENT_LIST EVENT 5 /end DAQ_EVENT
 /end IF_DATA
/end MEASUREMENT
/begin COMPU_METHOD channel_10.Conv "" LINEAR "%6.3" "Volt" COEFFS_LINEAR 1 0 /end COMPU_METHOD
/begin MEASUREMENT channel_10 "sine: f64" FLOAT64_IEEE channel_10.Conv 0 0 -1E15 1E15 ECU_ADDRESS 0xE0000 ECU_ADDRESS_EXTENSION 2
 /begin IF_DATA XCP
  /begin DAQ_EVENT FIXED_EVENT_LIST EVENT 14 /end DAQ_EVENT
 /end IF_DATA
/end MEASUREMENT
/begin COMPU_METHOD channel_2.Conv "" LINEAR "%6.3" "Volt" COEFFS_LINEAR 1 0 /end COMPU_METHOD
/begin MEASUREMENT channel_2 "sine: f64" FLOAT64_IEEE channel_2.Conv 0 0 -1E15 1E15 ECU_ADDRESS 0x60000 ECU_ADDRESS_EXTENSION 2
 /begin IF_DATA XCP
  /begin DAQ_EVENT FIXED_EVENT_LIST EVENT 6 /end DAQ_EVENT
 /end IF_DATA
/end MEASUREMENT
/begin COMPU_METHOD channel_3.Conv "" LINEAR "%6.3" "Volt" COEFFS_LINEAR 1 0 /end COMPU_METHOD
/begin MEASUREMENT channel_3 "sine: f64" FLOAT64_IEEE channel_3.Conv 0 0 -1E15 1E15 ECU_ADDRESS 0x70000 ECU_ADDRESS_EXTENSION 2
 /begin IF_DATA XCP
  /begin DAQ_EVENT FIXED_EVENT_LIST EVENT 7 /end DAQ_EVENT
 /end IF_DATA
/end MEASUREMENT
/begin COMPU_METHOD channel_4.Conv "" LINEAR "%6.3" "Volt" COEFFS_LINEAR 1 0 /end COMPU_METHOD
/begin MEASUREMENT channel_4 "sine: f64" FLOAT64_IEEE channel_4.Conv 0 0 -1E15 1E15 ECU_ADDRESS 0x80000 ECU_ADDRESS_EXTENSION 2
 /begin IF_DATA XCP
  /begin DAQ_EVENT FIXED_EVENT_LIST EVENT 8 /end DAQ_EVENT
 /end IF_DATA
/end MEASUREMENT
/begin COMPU_METHOD channel_5.Conv "" LINEAR "%6.3" "Volt" COEFFS_LINEAR 1 0 /end COMPU_METHOD
/begin MEASUREMENT channel_5 "sine: f64" FLOAT64_IEEE channel_5.Conv 0 0 -1E15 1E15 ECU_ADDRESS 0x90000 ECU_ADDRESS_EXTENSION 2
 /begin IF_DATA XCP
  /begin DAQ_EVENT FIXED_EVENT_LIST EVENT 9 /end DAQ_EVENT
 /end IF_DATA
/end MEASUREMENT
/begin COMPU_METHOD channel_6.Conv "" LINEAR "%6.3" "Volt" COEFFS_LINEAR 1 0 /end COMPU_METHOD
/begin MEASUREMENT channel_6 "sine: f64" FLOAT64_IEEE channel_6.Conv 0 0 -1E15 1E15 ECU_ADDRESS 0xA0000 ECU_ADDRESS_EXTENSION 2
 /begin IF_DATA XCP
  /begin DAQ_EVENT FIXED_EVENT_LIST EVENT 10 /end DAQ_EVENT
 /end IF_DATA
/end MEASUREMENT
/begin COMPU_METHOD channel_7.Conv "" LINEAR "%6.3" "Volt" COEFFS_LINEAR 1 0 /end COMPU_METHOD
/begin MEASUREMENT channel_7 "sine: f64" FLOAT64_IEEE channel_7.Conv 0 0 -1E15 1E15 ECU_ADDRESS 0xB0000 ECU_ADDRESS_EXTENSION 2
 /begin IF_DATA XCP
  /begin DAQ_EVENT FIXED_EVENT_LIST EVENT 11 /end DAQ_EVENT
 /end IF_DATA
/end MEASUREMENT
/begin COMPU_METHOD channel_8.Conv "" LINEAR "%6.3" "Volt" COEFFS_LINEAR 1 0 /end COMPU_METHOD
/begin MEASUREMENT channel_8 "sine: f64" FLOAT64_IEEE channel_8.Conv 0 0 -1E15 1E15 ECU_ADDRESS 0xC0000 ECU_ADDRESS_EXTENSION 2
 /begin IF_DATA XCP
  /begin DAQ_EVENT FIXED_EVENT_LIST EVENT 12 /end DAQ_EVENT
 /end IF_DATA
/end MEASUREMENT
/begin COMPU_METHOD channel_9.Conv "" LINEAR "%6.3" "Volt" COEFFS_LINEAR 1 0 /end COMPU_METHOD
/begin MEASUREMENT channel_9 "sine: f64" FLOAT64_IEEE channel_9.Conv 0 0 -1E15 1E15 ECU_ADDRESS 0xD0000 ECU_ADDRESS_EXTENSION 2
 /begin IF_DATA XCP
  /begin DAQ_EVENT FIXED_EVENT_LIST EVENT 13 /end DAQ_EVENT
 /end IF_DATA
/end MEASUREMENT
/begin MEASUREMENT counter "" ULONG NO_COMPU_METHOD 0 0 0 4294967295 PHYS_UNIT "" ECU_ADDRESS 0x4F7B8 ECU_ADDRESS_EXTENSION 2
 /begin IF_DATA XCP
  /begin DAQ_EVENT FIXED_EVENT_LIST EVENT 4 /end DAQ_EVENT
 /end IF_DATA
/end MEASUREMENT
/begin MEASUREMENT counter_i16 "wrapping counter: i16" SWORD NO_COMPU_METHOD 0 0 -32768 32767 PHYS_UNIT "" ECU_ADDRESS 0x4F7C2 ECU_ADDRESS_EXTENSION 2
 /begin IF_DATA XCP
  /begin DAQ_EVENT FIXED_EVENT_LIST EVENT 4 /end DAQ_EVENT
 /end IF_DATA
/end MEASUREMENT
/begin MEASUREMENT counter_i32 "wrapping counter: i32" SLONG NO_COMPU_METHOD 0 0 -2147483648 2147483647 PHYS_UNIT "" ECU_ADDRESS 0x4F7C8 ECU_ADDRESS_EXTENSION 2
 /begin IF_DATA XCP
  /begin DAQ_EVENT FIXED_EVENT_LIST EVENT 4 /end DAQ_EVENT
 /end IF_DATA
/end MEASUREMENT
/begin MEASUREMENT counter_i64 "wrapping counter: i64" A_INT64 NO_COMPU_METHOD 0 0 -1E15 1E15 PHYS_UNIT "" ECU_ADDRESS 0x4F7D4 ECU_ADDRESS_EXTENSION 2
 /begin IF_DATA XCP
  /begin DAQ_EVENT FIXED_EVENT_LIST EVENT 4 /end DAQ_EVENT
 /end IF_DATA
/end MEASUREMENT
/begin MEASUREMENT counter_i8 "wrapping counter: i8" SBYTE NO_COMPU_METHOD 0 0 -128 127 PHYS_UNIT "" ECU_ADDRESS 0x4F7BF ECU_ADDRESS_EXTENSION 2
 /begin IF_DATA XCP
  /begin DAQ_EVENT FIXED_EVENT_LIST EVENT 4 /end DAQ_EVENT
 /end IF_DATA
/end MEASUREMENT
/begin MEASUREMENT counter_isize "wrapping counter: i64" A_INT64 NO_COMPU_METHOD 0 0 -1E15 1E15 PHYS_UNIT "" ECU_ADDRESS 0x4F7E4 ECU_ADDRESS_EXTENSION 2
 /begin IF_DATA XCP
  /begin DAQ_EVENT FIXED_EVENT_LIST EVENT 4 /end DAQ_EVENT
 /end IF_DATA
/end MEASUREMENT
/begin MEASUREMENT counter_option_u16 "wrapping counter optional: u8" UWORD NO_COMPU_METHOD 0 0 0 65535 PHYS_UNIT "" ECU_ADDRESS 0x4F7F0 ECU_ADDRESS_EXTENSION 2
 /begin IF_DATA XCP
  /begin DAQ_EVENT FIXED_EVENT_LIST EVENT 4 /end DAQ_EVENT
 /end IF_DATA
/end MEASUREMENT
/begin MEASUREMENT counter_u16 "wrapping counter: u16" UWORD NO_COMPU_METHOD 0 0 0 65535 PHYS_UNIT "" ECU_ADDRESS 0x4F7C0 ECU_ADDRESS_EXTENSION 2
 /begin IF_DATA XCP
  /begin DAQ_EVENT FIXED_EVENT_LIST EVENT 4 /end DAQ_EVENT
 /end IF_DATA
/end MEASUREMENT
/begin MEASUREMENT counter_u32 "wrapping counter: u32" ULONG NO_COMPU_METHOD 0 0 0 4294967295 PHYS_UNIT "" ECU_ADDRESS 0x4F7C4 ECU_ADDRESS_EXTENSION 2
 /begin IF_DATA XCP
  /begin DAQ_EVENT FIXED_EVENT_LIST EVENT 4 /end DAQ_EVENT
 /end IF_DATA
/end MEASUREMENT
/begin MEASUREMENT counter_u64 "wrapping counter: u64" A_UINT64 NO_COMPU_METHOD 0 0 0 1E15 PHYS_UNIT "" ECU_ADDRESS 0x4F7CC ECU_ADDRESS_EXTENSION 2
 /begin IF_DATA XCP
  /begin DAQ_EVENT FIXED_EVENT_LIST EVENT 4 /end DAQ_EVENT
 /end IF_DATA
/end MEASUREMENT
/begin MEASUREMENT counter_u8 "wrapping counter: u8" UBYTE NO_COMPU_METHOD 0 0 0 255 PHYS_UNIT "" ECU_ADDRESS 0x4F7BE ECU_ADDRESS_EXTENSION 2
 /begin IF_DATA XCP
  /begin DAQ_EVENT FIXED_EVENT_LIST EVENT 4 /end DAQ_EVENT
 /end IF_DATA
/end MEASUREMENT
/begin MEASUREMENT counter_usize "wrapping counter: u64" A_UINT64 NO_COMPU_METHOD 0 0 0 1E15 PHYS_UNIT "" ECU_ADDRESS 0x4F7DC ECU_ADDRESS_EXTENSION 2
 /begin IF_DATA XCP
  /begin DAQ_EVENT FIXED_EVENT_LIST EVENT 4 /end DAQ_EVENT
 /end IF_DATA
/end MEASUREMENT
/begin MEASUREMENT mainloop_counter1 "" A_UINT64 NO_COMPU_METHOD 0 0 0 1E15 PHYS_UNIT "" ECU_ADDRESS 0xC ECU_ADDRESS_EXTENSION 2
 /begin IF_DATA XCP
  /begin DAQ_EVENT FIXED_EVENT_LIST EVENT 0 /end DAQ_EVENT
 /end IF_DATA
/end MEASUREMENT
/begin MEASUREMENT mainloop_local_var1 "" A_UINT64 NO_COMPU_METHOD 0 0 0 1E15 PHYS_UNIT "" ECU_ADDRESS 0x10104 ECU_ADDRESS_EXTENSION 2
 /begin IF_DATA XCP
  /begin DAQ_EVENT FIXED_EVENT_LIST EVENT 1 /end DAQ_EVENT
 /end IF_DATA
/end MEASUREMENT
/begin MEASUREMENT mainloop_local_var2 "" A_UINT64 NO_COMPU_METHOD 0 0 0 1E15 PHYS_UNIT "" ECU_ADDRESS 0x1010C ECU_ADDRESS_EXTENSION 2
 /begin IF_DATA XCP
  /begin DAQ_EVENT FIXED_EVENT_LIST EVENT 1 /end DAQ_EVENT
 /end IF_DATA
/end MEASUREMENT
/begin MEASUREMENT mainloop_map "2D map on heap" A_UINT64 NO_COMPU_METHOD 0 0 0 1E15 PHYS_UNIT "" ECU_ADDRESS 0x20000 ECU_ADDRESS_EXTENSION 2 MATRIX_DIM 16 16
 /begin IF_DATA XCP
  /begin DAQ_EVENT FIXED_EVENT_LIST EVENT 2 /end DAQ_EVENT
 /end IF_DATA
/end MEASUREMENT
/begin GROUP mainloop_local "" ROOT /begin REF_MEASUREMENT mainloop_local_var1 mainloop_local_var2 /end REF_MEASUREMENT /end GROUP
/begin GROUP task1 "" ROOT
 /begin REF_MEASUREMENT array1 counter counter_i16 counter_i32 counter_i64 counter_i8 counter_isize counter_option_u16 counter_u16 counter_u32 counter_u64 counter_u8 counter_usize /end REF_MEASUREMENT
/end GROUP
/begin GROUP task2_inst "" ROOT
 /begin REF_MEASUREMENT channel_1 channel_10 channel_2 channel_3 channel_4 channel_5 channel_6 channel_7 channel_8 channel_9 /end REF_MEASUREMENT
/end GROUP
/begin CHARACTERISTIC static_cal_page.task1_cycle_time_us "task1 cycle time" VALUE 0x1483B4 U32 0 NO_COMPU_METHOD 0 4294967295 PHYS_UNIT "us" ECU_ADDRESS_EXTENSION 1 /end CHARACTERISTIC
/begin CHARACTERISTIC static_cal_page.task2_cycle_time_us "task2 cycle time" VALUE 0x1483B8 U32 0 NO_COMPU_METHOD 0 4294967295 PHYS_UNIT "us" ECU_ADDRESS_EXTENSION 1 /end CHARACTERISTIC
/begin CHARACTERISTIC static_vars.test_f64 "Test static f64" VALUE 0x148780 F64 0 NO_COMPU_METHOD -1000000000000 1000000000000 ECU_ADDRESS_EXTENSION 1
 /begin IF_DATA XCP
  /begin DAQ_EVENT FIXED_EVENT_LIST EVENT 3 /end DAQ_EVENT
 /end IF_DATA
/end CHARACTERISTIC
/begin CHARACTERISTIC static_vars.test_u32 "Test static u32" VALUE 0x148788 U32 0 NO_COMPU_METHOD 0 4294967295 ECU_ADDRESS_EXTENSION 1
 /begin IF_DATA XCP
  /begin DAQ_EVENT FIXED_EVENT_LIST EVENT 3 /end DAQ_EVENT
 /end IF_DATA
/end CHARACTERISTIC
/begin CHARACTERISTIC CalPage.cycle_time_ms "main task cycle time" VALUE 0x80010000 U32 0 NO_COMPU_METHOD 0 4294967295 PHYS_UNIT "ms" /end CHARACTERISTIC
/begin CHARACTERISTIC CalPage.run "" VALUE 0x80010004 U8 0 NO_COMPU_METHOD 0 1 PHYS_UNIT "bool" /end CHARACTERISTIC
/begin CHARACTERISTIC CalPage.run1 "" VALUE 0x80010005 U8 0 NO_COMPU_METHOD 0 1 PHYS_UNIT "bool" /end CHARACTERISTIC
/begin CHARACTERISTIC CalPage.run2 "" VALUE 0x80010006 U8 0 NO_COMPU_METHOD 0 1 PHYS_UNIT "bool" /end CHARACTERISTIC
/begin GROUP CalPage "" ROOT
 /begin REF_CHARACTERISTIC CalPage.cycle_time_ms CalPage.run CalPage.run1 CalPage.run2 /end REF_CHARACTERISTIC
/end GROUP
/begin CHARACTERISTIC CalPage1.test_u64 "" VALUE 0x80020000 U64 0 NO_COMPU_METHOD 0 1000000000000 /end CHARACTERISTIC
/begin CHARACTERISTIC CalPage1.test_i64 "" VALUE 0x80020008 S64 0 NO_COMPU_METHOD -1000000000000 1000000000000 /end CHARACTERISTIC
/begin CHARACTERISTIC CalPage1.test_f64 "" VALUE 0x80020010 F64 0 NO_COMPU_METHOD -1000000000000 1000000000000 /end CHARACTERISTIC
/begin CHARACTERISTIC CalPage1.TestStruct1.test_u64 "" VALUE 0x80020018 U64 0 NO_COMPU_METHOD 0 1000000000000 /end CHARACTERISTIC
/begin CHARACTERISTIC CalPage1.TestStruct1.test_i64 "" VALUE 0x80020020 S64 0 NO_COMPU_METHOD -1000000000000 1000000000000 /end CHARACTERISTIC
/begin CHARACTERISTIC CalPage1.TestStruct1.test_f64 "" VALUE 0x80020028 F64 0 NO_COMPU_METHOD -1000000000000 1000000000000 /end CHARACTERISTIC
/begin CHARACTERISTIC CalPage1.TestStruct1.TestStruct2.test_u64 "" VALUE 0x80020030 U64 0 NO_COMPU_METHOD 0 1000000000000 /end CHARACTERISTIC
/begin CHARACTERISTIC CalPage1.TestStruct1.TestStruct2.test_i64 "" VALUE 0x80020038 S64 0 NO_COMPU_METHOD -1000000000000 1000000000000 /end CHARACTERISTIC
/begin CHARACTERISTIC CalPage1.TestStruct1.TestStruct2.test_f64 "" VALUE 0x80020040 F64 0 NO_COMPU_METHOD -1000000000000 1000000000000 /end CHARACTERISTIC
/begin CHARACTERISTIC CalPage1.TestStruct1.TestStruct2.test_u32 "" VALUE 0x80020048 U32 0 NO_COMPU_METHOD 0 4294967295 /end CHARACTERISTIC
/begin CHARACTERISTIC CalPage1.TestStruct1.TestStruct2.test_i32 "" VALUE 0x8002004C S32 0 NO_COMPU_METHOD -2147483648 2147483647 /end CHARACTERISTIC
/begin CHARACTERISTIC CalPage1.TestStruct1.TestStruct2.test_f32 "" VALUE 0x80020050 F32 0 NO_COMPU_METHOD -1000000000000 1000000000000 /end CHARACTERISTIC
/begin CHARACTERISTIC CalPage1.TestStruct1.TestStruct2.test_u16 "" VALUE 0x80020054 U16 0 NO_COMPU_METHOD 0 65535 /end CHARACTERISTIC
/begin CHARACTERISTIC CalPage1.TestStruct1.TestStruct2.test_i16 "" VALUE 0x80020056 S16 0 NO_COMPU_METHOD -32768 32767 /end CHARACTERISTIC
/begin CHARACTERISTIC CalPage1.TestStruct1.TestStruct2.test_u8 "" VALUE 0x80020058 U8 0 NO_COMPU_METHOD 0 255 /end CHARACTERISTIC
/begin CHARACTERISTIC CalPage1.TestStruct1.TestStruct2.test_i8 "" VALUE 0x80020059 S8 0 NO_COMPU_METHOD -128 127 /end CHARACTERISTIC
/begin CHARACTERISTIC CalPage1.TestStruct1.TestStruct2.test_bool "" VALUE 0x8002005A U8 0 NO_COMPU_METHOD 0 255 /end CHARACTERISTIC
/begin CHARACTERISTIC CalPage1.TestStruct1.test_u32 "" VALUE 0x80020060 U32 0 NO_COMPU_METHOD 0 4294967295 /end CHARACTERISTIC
/begin CHARACTERISTIC CalPage1.TestStruct1.test_i32 "" VALUE 0x80020064 S32 0 NO_COMPU_METHOD -2147483648 2147483647 /end CHARACTERISTIC
/begin CHARACTERISTIC CalPage1.TestStruct1.test_f32 "" VALUE 0x80020068 F32 0 NO_COMPU_METHOD -1000000000000 1000000000000 /end CHARACTERISTIC
/begin CHARACTERISTIC CalPage1.TestStruct1.test_u16 "" VALUE 0x8002006C U16 0 NO_COMPU_METHOD 0 65535 /end CHARACTERISTIC
/begin CHARACTERISTIC CalPage1.TestStruct1.test_i16 "" VALUE 0x8002006E S16 0 NO_COMPU_METHOD -32768 32767 /end CHARACTERISTIC
/begin CHARACTERISTIC CalPage1.TestStruct1.test_u8 "" VALUE 0x80020070 U8 0 NO_COMPU_METHOD 0 255 /end CHARACTERISTIC
/begin CHARACTERISTIC CalPage1.TestStruct1.test_i8 "" VALUE 0x80020071 S8 0 NO_COMPU_METHOD -128 127 /end CHARACTERISTIC
/begin CHARACTERISTIC CalPage1.TestStruct1.test_bool "" VALUE 0x80020072 U8 0 NO_COMPU_METHOD 0 255 /end CHARACTERISTIC
/begin CHARACTERISTIC CalPage1.counter_max "" VALUE 0x80020078 U32 0 NO_COMPU_METHOD 0 4294967295 /end CHARACTERISTIC
/begin CHARACTERISTIC CalPage1.test_u32 "" VALUE 0x8002007C U32 0 NO_COMPU_METHOD 0 4294967295 /end CHARACTERISTIC
/begin CHARACTERISTIC CalPage1.test_i32 "" VALUE 0x80020080 S32 0 NO_COMPU_METHOD -2147483648 2147483647 /end CHARACTERISTIC
/begin CHARACTERISTIC CalPage1.test_f32 "" VALUE 0x80020084 F32 0 NO_COMPU_METHOD -1000000000000 1000000000000 /end CHARACTERISTIC
/begin CHARACTERISTIC CalPage1.test_u16 "" VALUE 0x80020088 U16 0 NO_COMPU_METHOD 0 65535 /end CHARACTERISTIC
/begin CHARACTERISTIC CalPage1.test_i16 "" VALUE 0x8002008A S16 0 NO_COMPU_METHOD -32768 32767 /end CHARACTERISTIC
/begin CHARACTERISTIC CalPage1.test_u8 "" VALUE 0x8002008C U8 0 NO_COMPU_METHOD 0 255 /end CHARACTERISTIC
/begin CHARACTERISTIC CalPage1.test_i8 "" VALUE 0x8002008D S8 0 NO_COMPU_METHOD -128 127 /end CHARACTERISTIC
/begin CHARACTERISTIC CalPage1.test_bool "" VALUE 0x8002008E U8 0 NO_COMPU_METHOD 0 255 /end CHARACTERISTIC
/begin GROUP CalPage1 "" ROOT
 /begin REF_CHARACTERISTIC CalPage1.test_u64 CalPage1.test_i64 CalPage1.test_f64 CalPage1.TestStruct1.test_u64 CalPage1.TestStruct1.test_i64 CalPage1.TestStruct1.test_f64 CalPage1.TestStruct1.TestStruct2.test_u64 CalPage1.TestStruct1.TestStruct2.test_i64 CalPage1.TestStruct1.TestStruct2.test_f64 CalPage1.TestStruct1.TestStruct2.test_u32 CalPage1.TestStruct1.TestStruct2.test_i32 CalPage1.TestStruct1.TestStruct2.test_f32 CalPage1.TestStruct1.TestStruct2.test_u16 CalPage1.TestStruct1.TestStruct2.test_i16 CalPage1.TestStruct1.TestStruct2.test_u8 CalPage1.TestStruct1.TestStruct2.test_i8 CalPage1.TestStruct1.TestStruct2.test_bool CalPage1.TestStruct1.test_u32 CalPage1.TestStruct1.test_i32 CalPage1.TestStruct1.test_f32 CalPage1.TestStruct1.test_u16 CalPage1.TestStruct1.test_i16 CalPage1.TestStruct1.test_u8 CalPage1.TestStruct1.test_i8 CalPage1.TestStruct1.test_bool CalPage1.counter_max CalPage1.test_u32 CalPage1.test_i32 CalPage1.test_f32 CalPage1.test_u16 CalPage1.test_i16 CalPage1.test_u8 CalPage1.test_i8 CalPage1.test_bool /end REF_CHARACTERISTIC
/end GROUP
/begin CHARACTERISTIC CalPage2.array "Demo curve" CURVE 0x80030000 F64 0 NO_COMPU_METHOD 0 100
 /begin AXIS_DESCR FIX_AXIS NO_INPUT_QUANTITY NO_COMPU_METHOD 16 0 15 FIX_AXIS_PAR_DIST 0 1 16 /end AXIS_DESCR
 PHYS_UNIT "ms" /end CHARACTERISTIC
/begin CHARACTERISTIC CalPage2.ampl "Amplitude" VALUE 0x80030080 F64 0 NO_COMPU_METHOD 0 400 PHYS_UNIT "Volt" /end CHARACTERISTIC
/begin CHARACTERISTIC CalPage2.period "Period" VALUE 0x80030088 F64 0 NO_COMPU_METHOD 0 1000 PHYS_UNIT "s" /end CHARACTERISTIC
/begin CHARACTERISTIC CalPage2.map "Demo map" MAP 0x80030090 U8 0 NO_COMPU_METHOD -100 100
 /begin AXIS_DESCR FIX_AXIS NO_INPUT_QUANTITY NO_COMPU_METHOD 8 0 7 FIX_AXIS_PAR_DIST 0 1 8 /end AXIS_DESCR
 /begin AXIS_DESCR FIX_AXIS NO_INPUT_QUANTITY NO_COMPU_METHOD 9 0 8 FIX_AXIS_PAR_DIST 0 1 9 /end AXIS_DESCR
 PHYS_UNIT "ms" /end CHARACTERISTIC
/begin GROUP CalPage2 "" ROOT /begin REF_CHARACTERISTIC CalPage2.array CalPage2.ampl CalPage2.period CalPage2.map /end REF_CHARACTERISTIC /end GROUP
/end MODULE
/end PROJECT
