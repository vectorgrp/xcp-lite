ASAP2_VERSION 1 71
/begin PROJECT C_Demo ""
/begin HEADER "" VERSION "1.0" PROJECT_NO VECTOR /end HEADER
/begin MODULE C_Demo ""
/include "XCP_104.aml"
/begin MOD_COMMON "" BYTE_ORDER MSB_LAST ALIGNMENT_BYTE 1 ALIGNMENT_WORD 1 ALIGNMENT_LONG 1 ALIGNMENT_FLOAT16_IEEE 1 ALIGNMENT_FLOAT32_IEEE 1 ALIGNMENT_FLOAT64_IEEE 1 ALIGNMENT_INT64 1 /end MOD_COMMON
/begin TYPEDEF_STRUCTURE params_t "Calibration parameters typedef" 0x54 /begin STRUCTURE_COMPONENT test_byte1 C_test_byte1 0x8 /end STRUCTURE_COMPONENT /begin STRUCTURE_COMPONENT test_byte2 C_test_byte2 0x9 /end STRUCTURE_COMPONENT /begin STRUCTURE_COMPONENT counter_max C_counter_max 0x0 /end STRUCTURE_COMPONENT /begin STRUCTURE_COMPONENT delay_us C_delay_us 0x4 /end STRUCTURE_COMPONENT /begin STRUCTURE_COMPONENT curve C_curve 0xA /end STRUCTURE_COMPONENT /begin STRUCTURE_COMPONENT map C_map 0x12 /end STRUCTURE_COMPONENT /end TYPEDEF_STRUCTURE
/* Relative addressing mode: calseg=Parameters */
/begin INSTANCE params "Calibration parameters" params_t 0x80010000 /end INSTANCE
/* Absolute addressing mode: event=mainloop (0), addr_ext=1, addr_base=0x104320000 */
/begin MEASUREMENT g_counter8 "Measurement variable" UBYTE NO_COMPU_METHOD 0 0 0 255 ECU_ADDRESS 0x20048 ECU_ADDRESS_EXTENSION 1 READ_WRITE
 /begin IF_DATA XCP
  /begin DAQ_EVENT VARIABLE DEFAULT_EVENT_LIST EVENT 0x0 /end DAQ_EVENT
 /end IF_DATA
/end MEASUREMENT
/begin MEASUREMENT g_counter16 "Measurement variable" UWORD NO_COMPU_METHOD 0 0 0 65535 ECU_ADDRESS 0x2004A ECU_ADDRESS_EXTENSION 1 READ_WRITE
 /begin IF_DATA XCP
  /begin DAQ_EVENT VARIABLE DEFAULT_EVENT_LIST EVENT 0x0 /end DAQ_EVENT
 /end IF_DATA
/end MEASUREMENT
/begin MEASUREMENT g_counter32 "Measurement variable" ULONG NO_COMPU_METHOD 0 0 0 4.29497e+09 ECU_ADDRESS 0x2004C ECU_ADDRESS_EXTENSION 1 READ_WRITE
 /begin IF_DATA XCP
  /begin DAQ_EVENT VARIABLE DEFAULT_EVENT_LIST EVENT 0x0 /end DAQ_EVENT
 /end IF_DATA
/end MEASUREMENT
/begin MEASUREMENT g_counter64 "Measurement variable" A_UINT64 NO_COMPU_METHOD 0 0 0 1e+12 ECU_ADDRESS 0x20050 ECU_ADDRESS_EXTENSION 1 READ_WRITE
 /begin IF_DATA XCP
  /begin DAQ_EVENT VARIABLE DEFAULT_EVENT_LIST EVENT 0x0 /end DAQ_EVENT
 /end IF_DATA
/end MEASUREMENT
/begin MEASUREMENT g_counter8s "Measurement variable" SBYTE NO_COMPU_METHOD 0 0 -128 127 ECU_ADDRESS 0x20058 ECU_ADDRESS_EXTENSION 1 READ_WRITE
 /begin IF_DATA XCP
  /begin DAQ_EVENT VARIABLE DEFAULT_EVENT_LIST EVENT 0x0 /end DAQ_EVENT
 /end IF_DATA
/end MEASUREMENT
/begin MEASUREMENT g_counter16s "Measurement variable" SWORD NO_COMPU_METHOD 0 0 -32768 32767 ECU_ADDRESS 0x2005A ECU_ADDRESS_EXTENSION 1 READ_WRITE
 /begin IF_DATA XCP
  /begin DAQ_EVENT VARIABLE DEFAULT_EVENT_LIST EVENT 0x0 /end DAQ_EVENT
 /end IF_DATA
/end MEASUREMENT
/begin MEASUREMENT g_counter32s "Measurement variable" SLONG NO_COMPU_METHOD 0 0 -2.14748e+09 2.14748e+09 ECU_ADDRESS 0x2005C ECU_ADDRESS_EXTENSION 1 READ_WRITE
 /begin IF_DATA XCP
  /begin DAQ_EVENT VARIABLE DEFAULT_EVENT_LIST EVENT 0x0 /end DAQ_EVENT
 /end IF_DATA
/end MEASUREMENT
/begin MEASUREMENT g_counter64s "Measurement variable" A_INT64 NO_COMPU_METHOD 0 0 -1e+12 1e+12 ECU_ADDRESS 0x20060 ECU_ADDRESS_EXTENSION 1 READ_WRITE
 /begin IF_DATA XCP
  /begin DAQ_EVENT VARIABLE DEFAULT_EVENT_LIST EVENT 0x0 /end DAQ_EVENT
 /end IF_DATA
/end MEASUREMENT
/* Relative addressing mode: event=mainloop (0), addr_ext=2, addr_base=0x16badede0 */
/begin MEASUREMENT counter8 "Measurement variable" UBYTE NO_COMPU_METHOD 0 0 0 255 ECU_ADDRESS 0xFB75 ECU_ADDRESS_EXTENSION 2 READ_WRITE
 /begin IF_DATA XCP
  /begin DAQ_EVENT FIXED_EVENT_LIST EVENT 0x0 /end DAQ_EVENT
 /end IF_DATA
/end MEASUREMENT
/begin MEASUREMENT counter16 "Measurement variable" UWORD NO_COMPU_METHOD 0 0 0 65535 ECU_ADDRESS 0xFB72 ECU_ADDRESS_EXTENSION 2 READ_WRITE
 /begin IF_DATA XCP
  /begin DAQ_EVENT FIXED_EVENT_LIST EVENT 0x0 /end DAQ_EVENT
 /end IF_DATA
/end MEASUREMENT
/begin MEASUREMENT counter32 "Measurement variable" ULONG NO_COMPU_METHOD 0 0 0 4.29497e+09 ECU_ADDRESS 0xFB6C ECU_ADDRESS_EXTENSION 2 READ_WRITE
 /begin IF_DATA XCP
  /begin DAQ_EVENT FIXED_EVENT_LIST EVENT 0x0 /end DAQ_EVENT
 /end IF_DATA
/end MEASUREMENT
/begin MEASUREMENT counter64 "Measurement variable" A_UINT64 NO_COMPU_METHOD 0 0 0 1e+12 ECU_ADDRESS 0xFB60 ECU_ADDRESS_EXTENSION 2 READ_WRITE
 /begin IF_DATA XCP
  /begin DAQ_EVENT FIXED_EVENT_LIST EVENT 0x0 /end DAQ_EVENT
 /end IF_DATA
/end MEASUREMENT
/begin MEASUREMENT counter8s "Measurement variable" SBYTE NO_COMPU_METHOD 0 0 -128 127 ECU_ADDRESS 0xFB5F ECU_ADDRESS_EXTENSION 2 READ_WRITE
 /begin IF_DATA XCP
  /begin DAQ_EVENT FIXED_EVENT_LIST EVENT 0x0 /end DAQ_EVENT
 /end IF_DATA
/end MEASUREMENT
/begin MEASUREMENT counter16s "Measurement variable" SWORD NO_COMPU_METHOD 0 0 -32768 32767 ECU_ADDRESS 0xFB5C ECU_ADDRESS_EXTENSION 2 READ_WRITE
 /begin IF_DATA XCP
  /begin DAQ_EVENT FIXED_EVENT_LIST EVENT 0x0 /end DAQ_EVENT
 /end IF_DATA
/end MEASUREMENT
/begin MEASUREMENT counter32s "Measurement variable" SLONG NO_COMPU_METHOD 0 0 -2.14748e+09 2.14748e+09 ECU_ADDRESS 0xFB58 ECU_ADDRESS_EXTENSION 2 READ_WRITE
 /begin IF_DATA XCP
  /begin DAQ_EVENT FIXED_EVENT_LIST EVENT 0x0 /end DAQ_EVENT
 /end IF_DATA
/end MEASUREMENT
/begin MEASUREMENT counter64s "Measurement variable" A_INT64 NO_COMPU_METHOD 0 0 -1e+12 1e+12 ECU_ADDRESS 0xFB50 ECU_ADDRESS_EXTENSION 2 READ_WRITE
 /begin IF_DATA XCP
  /begin DAQ_EVENT FIXED_EVENT_LIST EVENT 0x0 /end DAQ_EVENT
 /end IF_DATA
/end MEASUREMENT
/begin CHARACTERISTIC array_f32 "array float[8]" VAL_BLK 0xFDD0 F32 0 NO_COMPU_METHOD -1e12 1e12 MATRIX_DIM 8 1 ECU_ADDRESS_EXTENSION 2
 /begin IF_DATA XCP
  /begin DAQ_EVENT FIXED_EVENT_LIST EVENT 0x0 /end DAQ_EVENT
 /end IF_DATA
/end CHARACTERISTIC
/begin CHARACTERISTIC matrix_f32 "matrix float[4][8]" VAL_BLK 0xFD50 F32 0 NO_COMPU_METHOD -1e12 1e12 MATRIX_DIM 8 4 ECU_ADDRESS_EXTENSION 2
 /begin IF_DATA XCP
  /begin DAQ_EVENT FIXED_EVENT_LIST EVENT 0x0 /end DAQ_EVENT
 /end IF_DATA
/end CHARACTERISTIC
/begin TYPEDEF_STRUCTURE params_measurement_t "The calibration parameter struct as measurement typedef" 0x54 /begin STRUCTURE_COMPONENT test_byte1 M_I8 0x8 /end STRUCTURE_COMPONENT /begin STRUCTURE_COMPONENT test_byte2 M_I8 0x9 /end STRUCTURE_COMPONENT /begin STRUCTURE_COMPONENT counter_max M_U16 0x0 /end STRUCTURE_COMPONENT /begin STRUCTURE_COMPONENT delay_us M_U32 0x4 /end STRUCTURE_COMPONENT /end TYPEDEF_STRUCTURE
/* Absolute addressing mode: event=mainloop (0), addr_ext=1, addr_base=0x104320000 */
/begin INSTANCE params_copy "A copy of the current calibration parameters" params_measurement_t 0x200CC ECU_ADDRESS_EXTENSION 1
 /begin IF_DATA XCP
  /begin DAQ_EVENT VARIABLE DEFAULT_EVENT_LIST EVENT 0x0 /end DAQ_EVENT
 /end IF_DATA
/end INSTANCE
/* Typedefs */
/begin RECORD_LAYOUT F64 FNC_VALUES 1 FLOAT64_IEEE ROW_DIR DIRECT /end RECORD_LAYOUT
/begin TYPEDEF_MEASUREMENT M_F64 "" FLOAT64_IEEE NO_COMPU_METHOD 0 0 -1e12 1e12 /end TYPEDEF_MEASUREMENT
/begin TYPEDEF_CHARACTERISTIC C_F64 "" VALUE F64 0 NO_COMPU_METHOD -1e12 1e12 /end TYPEDEF_CHARACTERISTIC
/begin RECORD_LAYOUT F32 FNC_VALUES 1 FLOAT32_IEEE ROW_DIR DIRECT /end RECORD_LAYOUT
/begin TYPEDEF_MEASUREMENT M_F32 "" FLOAT32_IEEE NO_COMPU_METHOD 0 0 -1e12 1e12 /end TYPEDEF_MEASUREMENT
/begin TYPEDEF_CHARACTERISTIC C_F32 "" VALUE F32 0 NO_COMPU_METHOD -1e12 1e12 /end TYPEDEF_CHARACTERISTIC
/begin RECORD_LAYOUT I64 FNC_VALUES 1 A_INT64 ROW_DIR DIRECT /end RECORD_LAYOUT
/begin TYPEDEF_MEASUREMENT M_I64 "" A_INT64 NO_COMPU_METHOD 0 0 -1e12 1e12 /end TYPEDEF_MEASUREMENT
/begin TYPEDEF_CHARACTERISTIC C_I64 "" VALUE I64 0 NO_COMPU_METHOD -1e12 1e12 /end TYPEDEF_CHARACTERISTIC
/begin RECORD_LAYOUT I32 FNC_VALUES 1 SLONG ROW_DIR DIRECT /end RECORD_LAYOUT
/begin TYPEDEF_MEASUREMENT M_I32 "" SLONG NO_COMPU_METHOD 0 0 -2147483648 2147483647 /end TYPEDEF_MEASUREMENT
/begin TYPEDEF_CHARACTERISTIC C_I32 "" VALUE I32 0 NO_COMPU_METHOD -2147483648 2147483647 /end TYPEDEF_CHARACTERISTIC
/begin RECORD_LAYOUT I16 FNC_VALUES 1 SWORD ROW_DIR DIRECT /end RECORD_LAYOUT
/begin TYPEDEF_MEASUREMENT M_I16 "" SWORD NO_COMPU_METHOD 0 0 -32768 32767 /end TYPEDEF_MEASUREMENT
/begin TYPEDEF_CHARACTERISTIC C_I16 "" VALUE I16 0 NO_COMPU_METHOD -32768 32767 /end TYPEDEF_CHARACTERISTIC
/begin RECORD_LAYOUT I8 FNC_VALUES 1 SBYTE ROW_DIR DIRECT /end RECORD_LAYOUT
/begin TYPEDEF_MEASUREMENT M_I8 "" SBYTE NO_COMPU_METHOD 0 0 -128 127 /end TYPEDEF_MEASUREMENT
/begin TYPEDEF_CHARACTERISTIC C_I8 "" VALUE I8 0 NO_COMPU_METHOD -128 127 /end TYPEDEF_CHARACTERISTIC
/begin RECORD_LAYOUT U8 FNC_VALUES 1 UBYTE ROW_DIR DIRECT /end RECORD_LAYOUT
/begin TYPEDEF_MEASUREMENT M_U8 "" UBYTE NO_COMPU_METHOD 0 0 0 255 /end TYPEDEF_MEASUREMENT
/begin TYPEDEF_CHARACTERISTIC C_U8 "" VALUE U8 0 NO_COMPU_METHOD 0 255 /end TYPEDEF_CHARACTERISTIC
/begin RECORD_LAYOUT U16 FNC_VALUES 1 UWORD ROW_DIR DIRECT /end RECORD_LAYOUT
/begin TYPEDEF_MEASUREMENT M_U16 "" UWORD NO_COMPU_METHOD 0 0 0 65535 /end TYPEDEF_MEASUREMENT
/begin TYPEDEF_CHARACTERISTIC C_U16 "" VALUE U16 0 NO_COMPU_METHOD 0 65535 /end TYPEDEF_CHARACTERISTIC
/begin RECORD_LAYOUT U32 FNC_VALUES 1 ULONG ROW_DIR DIRECT /end RECORD_LAYOUT
/begin TYPEDEF_MEASUREMENT M_U32 "" ULONG NO_COMPU_METHOD 0 0 0 4294967295 /end TYPEDEF_MEASUREMENT
/begin TYPEDEF_CHARACTERISTIC C_U32 "" VALUE U32 0 NO_COMPU_METHOD 0 4294967295 /end TYPEDEF_CHARACTERISTIC
/begin RECORD_LAYOUT U64 FNC_VALUES 1 A_UINT64 ROW_DIR DIRECT /end RECORD_LAYOUT
/begin TYPEDEF_MEASUREMENT M_U64 "" A_UINT64 NO_COMPU_METHOD 0 0 0 1e12 /end TYPEDEF_MEASUREMENT
/begin TYPEDEF_CHARACTERISTIC C_U64 "" VALUE U64 0 NO_COMPU_METHOD 0 1e12 /end TYPEDEF_CHARACTERISTIC
/begin TYPEDEF_CHARACTERISTIC C_test_byte1 "Test byte for calibration consistency test" VALUE I8 0 NO_COMPU_METHOD -128 127 /end TYPEDEF_CHARACTERISTIC
/begin TYPEDEF_CHARACTERISTIC C_test_byte2 "Test byte for calibration consistency test" VALUE I8 0 NO_COMPU_METHOD -128 127 /end TYPEDEF_CHARACTERISTIC
/begin TYPEDEF_CHARACTERISTIC C_counter_max "" VALUE U16 0 NO_COMPU_METHOD 0 2000 /end TYPEDEF_CHARACTERISTIC
/begin TYPEDEF_CHARACTERISTIC C_delay_us "Mainloop sleep time in us" VALUE U32 0 NO_COMPU_METHOD 0 1e+06 PHYS_UNIT "us" /end TYPEDEF_CHARACTERISTIC
/begin TYPEDEF_CHARACTERISTIC C_curve "Demo curve" CURVE I8 0 NO_COMPU_METHOD -128 127
 /begin AXIS_DESCR FIX_AXIS NO_INPUT_QUANTITY NO_COMPU_METHOD 8 0 7 FIX_AXIS_PAR_DIST 0 1 8 /end AXIS_DESCR
/end TYPEDEF_CHARACTERISTIC
/begin TYPEDEF_CHARACTERISTIC C_map "Demo map" MAP I8 0 NO_COMPU_METHOD -128 127
 /begin AXIS_DESCR FIX_AXIS NO_INPUT_QUANTITY NO_COMPU_METHOD 8 0 7 FIX_AXIS_PAR_DIST 0 1 8 /end AXIS_DESCR
 /begin AXIS_DESCR FIX_AXIS NO_INPUT_QUANTITY NO_COMPU_METHOD 8 0 7 FIX_AXIS_PAR_DIST 0 1 8 /end AXIS_DESCR
/end TYPEDEF_CHARACTERISTIC
/* Groups */
/begin GROUP Parameters "Calibration Segment" ROOT /begin REF_CHARACTERISTIC params /end REF_CHARACTERISTIC /end GROUP
/begin GROUP mainloop "Measurement event group"
 /begin REF_MEASUREMENT g_counter8 g_counter16 g_counter32 g_counter64 g_counter8s g_counter16s g_counter32s g_counter64s counter8 counter16 counter32 counter64 counter8s counter16s counter32s counter64s array_f32 matrix_f32 params_copy /end REF_MEASUREMENT
/end GROUP
/begin GROUP Events "Events" ROOT /begin SUB_GROUP mainloop /end SUB_GROUP /end GROUP
/* Conversions */
/begin MOD_PAR "" EPK "EPK_Jun_28_2025_14:46:14" ADDR_EPK 0x80000000 /begin MEMORY_SEGMENT epk "" DATA FLASH INTERN 0x80000000 24 -1 -1 -1 -1 -1 /end MEMORY_SEGMENT
 /begin MEMORY_SEGMENT Parameters "" DATA FLASH INTERN 0x80010000 0x54 -1 -1 -1 -1 -1
  /begin IF_DATA XCP
   /begin SEGMENT 0x1 0x2 0x0 0x0 0x0 /begin CHECKSUM XCP_ADD_44 MAX_BLOCK_SIZE 0xFFFF EXTERNAL_FUNCTION "" /end CHECKSUM
    /begin PAGE 0x1 ECU_ACCESS_DONT_CARE XCP_READ_ACCESS_DONT_CARE XCP_WRITE_ACCESS_NOT_ALLOWED /end PAGE
    /begin PAGE 0x0 ECU_ACCESS_DONT_CARE XCP_READ_ACCESS_DONT_CARE XCP_WRITE_ACCESS_DONT_CARE /end PAGE
   /end SEGMENT
  /end IF_DATA
 /end MEMORY_SEGMENT
/end MOD_PAR
/begin IF_DATA XCP
 /begin PROTOCOL_LAYER 0x104 1000 2000 0 0 0 0 0 248 1024 BYTE_ORDER_MSB_LAST ADDRESS_GRANULARITY_BYTE OPTIONAL_CMD GET_COMM_MODE_INFO OPTIONAL_CMD GET_ID OPTIONAL_CMD SET_REQUEST OPTIONAL_CMD SET_MTA OPTIONAL_CMD UPLOAD OPTIONAL_CMD SHORT_UPLOAD OPTIONAL_CMD DOWNLOAD OPTIONAL_CMD SHORT_DOWNLOAD OPTIONAL_CMD GET_CAL_PAGE OPTIONAL_CMD SET_CAL_PAGE OPTIONAL_CMD COPY_CAL_PAGE OPTIONAL_CMD BUILD_CHECKSUM OPTIONAL_CMD USER_CMD OPTIONAL_CMD GET_DAQ_RESOLUTION_INFO OPTIONAL_CMD GET_DAQ_PROCESSOR_INFO OPTIONAL_CMD FREE_DAQ OPTIONAL_CMD ALLOC_DAQ OPTIONAL_CMD ALLOC_ODT OPTIONAL_CMD ALLOC_ODT_ENTRY OPTIONAL_CMD SET_DAQ_PTR OPTIONAL_CMD WRITE_DAQ OPTIONAL_CMD GET_DAQ_LIST_MODE OPTIONAL_CMD SET_DAQ_LIST_MODE OPTIONAL_CMD START_STOP_SYNCH OPTIONAL_CMD START_STOP_DAQ_LIST OPTIONAL_CMD GET_DAQ_CLOCK OPTIONAL_CMD WRITE_DAQ_MULTIPLE OPTIONAL_CMD TIME_CORRELATION_PROPERTIES OPTIONAL_LEVEL1_CMD GET_VERSION /end PROTOCOL_LAYER
 /begin DAQ DYNAMIC 0 1 0 OPTIMISATION_TYPE_DEFAULT ADDRESS_EXTENSION_FREE IDENTIFICATION_FIELD_TYPE_RELATIVE_BYTE GRANULARITY_ODT_ENTRY_SIZE_DAQ_BYTE 0xF8 OVERLOAD_INDICATION_PID /begin TIMESTAMP_SUPPORTED 0x1 SIZE_DWORD UNIT_1NS TIMESTAMP_FIXED /end TIMESTAMP_SUPPORTED /begin EVENT "mainloop" "mainloop" 0x0 DAQ 0xFF 0 0 0 CONSISTENCY EVENT /end EVENT /end DAQ
 /begin XCP_ON_UDP_IP 0x104 5555 ADDRESS "192.168.0.128" /end XCP_ON_UDP_IP
/end IF_DATA
/end MODULE
/end PROJECT
