/* xcp-lite */ ASAP2_VERSION 1 71
/begin PROJECT all_features_demo ""
/begin HEADER "" VERSION "1.0" PROJECT_NO XCPLITE__CASDD /end HEADER
/begin MODULE all_features_demo ""
/include "XCP_104.aml"
/begin MOD_COMMON "" BYTE_ORDER MSB_LAST ALIGNMENT_BYTE 1 ALIGNMENT_WORD 1 ALIGNMENT_LONG 1 ALIGNMENT_FLOAT16_IEEE 1 ALIGNMENT_FLOAT32_IEEE 1 ALIGNMENT_FLOAT64_IEEE 1 ALIGNMENT_INT64 1 /end MOD_COMMON
/* Predefined conversion rule for bool */
/begin COMPU_METHOD BOOL "" TAB_VERB "%.0" "" COMPU_TAB_REF BOOL.table /end COMPU_METHOD
/begin COMPU_VTAB BOOL.table "" TAB_VERB 2 0 "false" 1 "true" /end COMPU_VTAB
/* Predefined conversion rule identity with no phys unit and zero decimal places */
/begin COMPU_METHOD IDENTITY "" IDENTICAL "%.0" "" /end COMPU_METHOD
/* Predefined characteristic record layouts for standard types */
/begin RECORD_LAYOUT BOOL FNC_VALUES 1 UBYTE ROW_DIR DIRECT /end RECORD_LAYOUT
/begin RECORD_LAYOUT U8 FNC_VALUES 1 UBYTE ROW_DIR DIRECT /end RECORD_LAYOUT
/begin RECORD_LAYOUT U16 FNC_VALUES 1 UWORD ROW_DIR DIRECT /end RECORD_LAYOUT
/begin RECORD_LAYOUT U32 FNC_VALUES 1 ULONG ROW_DIR DIRECT /end RECORD_LAYOUT
/begin RECORD_LAYOUT U64 FNC_VALUES 1 A_UINT64 ROW_DIR DIRECT /end RECORD_LAYOUT
/begin RECORD_LAYOUT I8 FNC_VALUES 1 SBYTE ROW_DIR DIRECT /end RECORD_LAYOUT
/begin RECORD_LAYOUT I16 FNC_VALUES 1 SWORD ROW_DIR DIRECT /end RECORD_LAYOUT
/begin RECORD_LAYOUT I32 FNC_VALUES 1 SLONG ROW_DIR DIRECT /end RECORD_LAYOUT
/begin RECORD_LAYOUT I64 FNC_VALUES 1 A_INT64 ROW_DIR DIRECT /end RECORD_LAYOUT
/begin RECORD_LAYOUT F32 FNC_VALUES 1 FLOAT32_IEEE ROW_DIR DIRECT /end RECORD_LAYOUT
/begin RECORD_LAYOUT F64 FNC_VALUES 1 FLOAT64_IEEE ROW_DIR DIRECT /end RECORD_LAYOUT
/* Predefined axis record layouts for standard types */
/begin RECORD_LAYOUT A_U8 AXIS_PTS_X 1 UBYTE INDEX_INCR DIRECT /end RECORD_LAYOUT
/begin RECORD_LAYOUT A_U16 AXIS_PTS_X 1 UWORD INDEX_INCR DIRECT /end RECORD_LAYOUT
/begin RECORD_LAYOUT A_U32 AXIS_PTS_X 1 ULONG INDEX_INCR DIRECT /end RECORD_LAYOUT
/begin RECORD_LAYOUT A_U64 AXIS_PTS_X 1 A_UINT64 INDEX_INCR DIRECT /end RECORD_LAYOUT
/begin RECORD_LAYOUT A_I8 AXIS_PTS_X 1 SBYTE INDEX_INCR DIRECT /end RECORD_LAYOUT
/begin RECORD_LAYOUT A_I16 AXIS_PTS_X 1 SWORD INDEX_INCR DIRECT /end RECORD_LAYOUT
/begin RECORD_LAYOUT A_I32 AXIS_PTS_X 1 SLONG INDEX_INCR DIRECT /end RECORD_LAYOUT
/begin RECORD_LAYOUT A_I64 AXIS_PTS_X 1 A_INT64 INDEX_INCR DIRECT /end RECORD_LAYOUT
/begin RECORD_LAYOUT A_F32 AXIS_PTS_X 1 FLOAT32_IEEE INDEX_INCR DIRECT /end RECORD_LAYOUT
/begin RECORD_LAYOUT A_F64 AXIS_PTS_X 1 FLOAT64_IEEE INDEX_INCR DIRECT /end RECORD_LAYOUT
/* Predefined measurement and characteristic typedefs for standard types */
/begin TYPEDEF_MEASUREMENT M_BOOL "" UBYTE BOOL 0 0 0 1 /end TYPEDEF_MEASUREMENT
/begin TYPEDEF_MEASUREMENT M_U8 "" UBYTE NO_COMPU_METHOD 0 0 0 255 /end TYPEDEF_MEASUREMENT
/begin TYPEDEF_MEASUREMENT M_U16 "" UWORD NO_COMPU_METHOD 0 0 0 65535 /end TYPEDEF_MEASUREMENT
/begin TYPEDEF_MEASUREMENT M_U32 "" ULONG NO_COMPU_METHOD 0 0 0 4294967295 /end TYPEDEF_MEASUREMENT
/begin TYPEDEF_MEASUREMENT M_U64 "" A_UINT64 NO_COMPU_METHOD 0 0 0 1e12 /end TYPEDEF_MEASUREMENT
/begin TYPEDEF_MEASUREMENT M_I8 "" SBYTE NO_COMPU_METHOD 0 0 -128 127 /end TYPEDEF_MEASUREMENT
/begin TYPEDEF_MEASUREMENT M_I16 "" SWORD NO_COMPU_METHOD 0 0 -32768 32767 /end TYPEDEF_MEASUREMENT
/begin TYPEDEF_MEASUREMENT M_I32 "" SLONG NO_COMPU_METHOD 0 0 -2147483648 2147483647 /end TYPEDEF_MEASUREMENT
/begin TYPEDEF_MEASUREMENT M_I64 "" A_INT64 NO_COMPU_METHOD 0 0 -1e12 1e12 /end TYPEDEF_MEASUREMENT
/begin TYPEDEF_MEASUREMENT M_F32 "" FLOAT32_IEEE NO_COMPU_METHOD 0 0 -1e12 1e12 /end TYPEDEF_MEASUREMENT
/begin TYPEDEF_MEASUREMENT M_F64 "" FLOAT64_IEEE NO_COMPU_METHOD 0 0 -1e12 1e12 /end TYPEDEF_MEASUREMENT
/begin TYPEDEF_CHARACTERISTIC C_BOOL "" VALUE U8 0 BOOL 0 1 /end TYPEDEF_CHARACTERISTIC
/begin TYPEDEF_CHARACTERISTIC C_U8 "" VALUE U8 0 NO_COMPU_METHOD 0 255 /end TYPEDEF_CHARACTERISTIC
/begin TYPEDEF_CHARACTERISTIC C_U16 "" VALUE U16 0 NO_COMPU_METHOD 0 65535 /end TYPEDEF_CHARACTERISTIC
/begin TYPEDEF_CHARACTERISTIC C_U32 "" VALUE U32 0 NO_COMPU_METHOD 0 4294967295 /end TYPEDEF_CHARACTERISTIC
/begin TYPEDEF_CHARACTERISTIC C_U64 "" VALUE U64 0 NO_COMPU_METHOD 0 1e12 /end TYPEDEF_CHARACTERISTIC
/begin TYPEDEF_CHARACTERISTIC C_I8 "" VALUE I8 0 NO_COMPU_METHOD -128 127 /end TYPEDEF_CHARACTERISTIC
/begin TYPEDEF_CHARACTERISTIC C_I16 "" VALUE I16 0 NO_COMPU_METHOD -32768 32767 /end TYPEDEF_CHARACTERISTIC
/begin TYPEDEF_CHARACTERISTIC C_I32 "" VALUE I32 0 NO_COMPU_METHOD -2147483648 2147483647 /end TYPEDEF_CHARACTERISTIC
/begin TYPEDEF_CHARACTERISTIC C_I64 "" VALUE I64 0 NO_COMPU_METHOD -1e12 1e12 /end TYPEDEF_CHARACTERISTIC
/begin TYPEDEF_CHARACTERISTIC C_F64 "" VALUE F64 0 NO_COMPU_METHOD -1e12 1e12 /end TYPEDEF_CHARACTERISTIC
/begin TYPEDEF_CHARACTERISTIC C_F32 "" VALUE F32 0 NO_COMPU_METHOD -1e12 1e12 /end TYPEDEF_CHARACTERISTIC
/begin MOD_PAR "" EPK "2026-07-07 13:05:45Z" ADDR_EPK 0x80000000
 /begin MEMORY_SEGMENT epk "" DATA FLASH INTERN 0x80000000 32 -1 -1 -1 -1 -1
  /begin IF_DATA XCP
   /begin SEGMENT 0 2 0 0 0 /begin CHECKSUM XCP_ADD_44 MAX_BLOCK_SIZE 0xFFFF EXTERNAL_FUNCTION "" /end CHECKSUM
    /begin PAGE 0x0 ECU_ACCESS_DONT_CARE XCP_READ_ACCESS_DONT_CARE XCP_WRITE_ACCESS_DONT_CARE /end PAGE
    /begin PAGE 0x1 ECU_ACCESS_DONT_CARE XCP_READ_ACCESS_DONT_CARE XCP_WRITE_ACCESS_NOT_ALLOWED /end PAGE
   /end SEGMENT
  /end IF_DATA
 /end MEMORY_SEGMENT
 /begin MEMORY_SEGMENT calseg "" DATA FLASH INTERN 0x80010000 8 -1 -1 -1 -1 -1
  /begin IF_DATA XCP
   /begin SEGMENT 1 2 0 0 0 /begin CHECKSUM XCP_ADD_44 MAX_BLOCK_SIZE 0xFFFF EXTERNAL_FUNCTION "" /end CHECKSUM
    /begin PAGE 0x0 ECU_ACCESS_DONT_CARE XCP_READ_ACCESS_DONT_CARE XCP_WRITE_ACCESS_DONT_CARE /end PAGE
    /begin PAGE 0x1 ECU_ACCESS_DONT_CARE XCP_READ_ACCESS_DONT_CARE XCP_WRITE_ACCESS_NOT_ALLOWED /end PAGE
   /end SEGMENT
  /end IF_DATA
 /end MEMORY_SEGMENT
 /begin MEMORY_SEGMENT calseg1 "" DATA FLASH INTERN 0x80020000 472 -1 -1 -1 -1 -1
  /begin IF_DATA XCP
   /begin SEGMENT 2 2 0 0 0 /begin CHECKSUM XCP_ADD_44 MAX_BLOCK_SIZE 0xFFFF EXTERNAL_FUNCTION "" /end CHECKSUM
    /begin PAGE 0x0 ECU_ACCESS_DONT_CARE XCP_READ_ACCESS_DONT_CARE XCP_WRITE_ACCESS_DONT_CARE /end PAGE
    /begin PAGE 0x1 ECU_ACCESS_DONT_CARE XCP_READ_ACCESS_DONT_CARE XCP_WRITE_ACCESS_NOT_ALLOWED /end PAGE
   /end SEGMENT
  /end IF_DATA
 /end MEMORY_SEGMENT
 /begin MEMORY_SEGMENT calseg2 "" DATA FLASH INTERN 0x80030000 560 -1 -1 -1 -1 -1
  /begin IF_DATA XCP
   /begin SEGMENT 3 2 0 0 0 /begin CHECKSUM XCP_ADD_44 MAX_BLOCK_SIZE 0xFFFF EXTERNAL_FUNCTION "" /end CHECKSUM
    /begin PAGE 0x0 ECU_ACCESS_DONT_CARE XCP_READ_ACCESS_DONT_CARE XCP_WRITE_ACCESS_DONT_CARE /end PAGE
    /begin PAGE 0x1 ECU_ACCESS_DONT_CARE XCP_READ_ACCESS_DONT_CARE XCP_WRITE_ACCESS_NOT_ALLOWED /end PAGE
   /end SEGMENT
  /end IF_DATA
 /end MEMORY_SEGMENT
/end MOD_PAR
/begin IF_DATA XCP
 /begin PROTOCOL_LAYER 0x0104 1000 2000 0 0 0 0 0 252 1468 BYTE_ORDER_MSB_LAST ADDRESS_GRANULARITY_BYTE OPTIONAL_CMD GET_COMM_MODE_INFO OPTIONAL_CMD GET_ID OPTIONAL_CMD SET_REQUEST OPTIONAL_CMD SET_MTA OPTIONAL_CMD UPLOAD OPTIONAL_CMD SHORT_UPLOAD OPTIONAL_CMD DOWNLOAD OPTIONAL_CMD SHORT_DOWNLOAD OPTIONAL_CMD GET_CAL_PAGE OPTIONAL_CMD SET_CAL_PAGE OPTIONAL_CMD COPY_CAL_PAGE OPTIONAL_CMD BUILD_CHECKSUM OPTIONAL_CMD GET_DAQ_RESOLUTION_INFO OPTIONAL_CMD GET_DAQ_PROCESSOR_INFO OPTIONAL_CMD FREE_DAQ OPTIONAL_CMD ALLOC_DAQ OPTIONAL_CMD ALLOC_ODT OPTIONAL_CMD ALLOC_ODT_ENTRY OPTIONAL_CMD SET_DAQ_PTR OPTIONAL_CMD WRITE_DAQ OPTIONAL_CMD GET_DAQ_LIST_MODE OPTIONAL_CMD SET_DAQ_LIST_MODE OPTIONAL_CMD START_STOP_SYNCH OPTIONAL_CMD START_STOP_DAQ_LIST OPTIONAL_CMD GET_DAQ_CLOCK OPTIONAL_CMD WRITE_DAQ_MULTIPLE OPTIONAL_CMD TIME_CORRELATION_PROPERTIES OPTIONAL_CMD USER_CMD OPTIONAL_LEVEL1_CMD GET_VERSION /end PROTOCOL_LAYER
 /begin DAQ DYNAMIC 0 14 0 OPTIMISATION_TYPE_DEFAULT ADDRESS_EXTENSION_FREE IDENTIFICATION_FIELD_TYPE_RELATIVE_BYTE GRANULARITY_ODT_ENTRY_SIZE_DAQ_BYTE 0xF8 OVERLOAD_INDICATION_PID /begin TIMESTAMP_SUPPORTED 0x1 SIZE_DWORD UNIT_1US TIMESTAMP_FIXED /end TIMESTAMP_SUPPORTED /begin EVENT "main" "main" 10 DAQ 0xFF 0 0 0 CONSISTENCY DAQ /end EVENT /begin EVENT "main_local" "in_local" 13 DAQ 0xFF 0 0 0 CONSISTENCY DAQ /end EVENT /begin EVENT "main_task1" "in_task1" 12 DAQ 0xFF 0 0 0 CONSISTENCY DAQ /end EVENT /begin EVENT "main_task2_1" "_task2_1" 0 DAQ 0xFF 0 0 0 CONSISTENCY DAQ /end EVENT /begin EVENT "main_task2_2" "_task2_2" 2 DAQ 0xFF 0 0 0 CONSISTENCY DAQ /end EVENT /begin EVENT "main_task2_3" "_task2_3" 3 DAQ 0xFF 0 0 0 CONSISTENCY DAQ /end EVENT /begin EVENT "main_task2_4" "_task2_4" 4 DAQ 0xFF 0 0 0 CONSISTENCY DAQ /end EVENT /begin EVENT "main_task2_5" "_task2_5" 5 DAQ 0xFF 0 0 0 CONSISTENCY DAQ /end EVENT /begin EVENT "main_task2_6" "_task2_6" 6 DAQ 0xFF 0 0 0 CONSISTENCY DAQ /end EVENT /begin EVENT "main_task2_7" "_task2_7" 7 DAQ 0xFF 0 0 0 CONSISTENCY DAQ /end EVENT /begin EVENT "main_task2_8" "_task2_8" 8 DAQ 0xFF 0 0 0 CONSISTENCY DAQ /end EVENT /begin EVENT "main_task2_9" "_task2_9" 9 DAQ 0xFF 0 0 0 CONSISTENCY DAQ /end EVENT
  /begin EVENT "main_task2_10" "task2_10" 11 DAQ 0xFF 0 0 0 CONSISTENCY DAQ /end EVENT
  /begin EVENT "main_task2s" "n_task2s" 1 DAQ 0xFF 0 0 0 CONSISTENCY DAQ /end EVENT
 /end DAQ
 /begin XCP_ON_UDP_IP 0x0104 5555 ADDRESS "0.0.0.0" /end XCP_ON_UDP_IP
/end IF_DATA
/* TypeDefs */
/begin TYPEDEF_CHARACTERISTIC run "" VALUE BOOL 0 BOOL 0 1 /end TYPEDEF_CHARACTERISTIC
/begin TYPEDEF_CHARACTERISTIC run1 "" VALUE BOOL 0 BOOL 0 1 /end TYPEDEF_CHARACTERISTIC
/begin TYPEDEF_CHARACTERISTIC run2 "" VALUE BOOL 0 BOOL 0 1 /end TYPEDEF_CHARACTERISTIC
/begin TYPEDEF_CHARACTERISTIC cycle_time_ms "" VALUE U32 0 IDENTITY 0 4294967295 /end TYPEDEF_CHARACTERISTIC
/begin TYPEDEF_STRUCTURE CalPage "" 8 /begin STRUCTURE_COMPONENT run run 4 /end STRUCTURE_COMPONENT /begin STRUCTURE_COMPONENT run1 run1 5 /end STRUCTURE_COMPONENT /begin STRUCTURE_COMPONENT run2 run2 6 /end STRUCTURE_COMPONENT /begin STRUCTURE_COMPONENT cycle_time_ms cycle_time_ms 0 /end STRUCTURE_COMPONENT /end TYPEDEF_STRUCTURE
/begin TYPEDEF_CHARACTERISTIC counter_max "" VALUE U32 0 IDENTITY 0 4294967295 /end TYPEDEF_CHARACTERISTIC
/begin TYPEDEF_CHARACTERISTIC test_bool "" VALUE BOOL 0 BOOL 0 1 /end TYPEDEF_CHARACTERISTIC
/begin TYPEDEF_CHARACTERISTIC test_u8 "" VALUE U8 0 IDENTITY 0 255 /end TYPEDEF_CHARACTERISTIC
/begin TYPEDEF_CHARACTERISTIC test_u16 "" VALUE U16 0 IDENTITY 0 65535 /end TYPEDEF_CHARACTERISTIC
/begin TYPEDEF_CHARACTERISTIC test_u32 "" VALUE U32 0 IDENTITY 0 4294967295 /end TYPEDEF_CHARACTERISTIC
/begin TYPEDEF_CHARACTERISTIC test_u64 "" VALUE U64 0 IDENTITY 0 18446744073709552000 /end TYPEDEF_CHARACTERISTIC
/begin TYPEDEF_CHARACTERISTIC test_i8 "" VALUE I8 0 IDENTITY -128 127 /end TYPEDEF_CHARACTERISTIC
/begin TYPEDEF_CHARACTERISTIC test_i16 "" VALUE I16 0 IDENTITY -32768 32767 /end TYPEDEF_CHARACTERISTIC
/begin TYPEDEF_CHARACTERISTIC test_i32 "" VALUE I32 0 IDENTITY -2147483648 2147483647 /end TYPEDEF_CHARACTERISTIC
/begin TYPEDEF_CHARACTERISTIC test_i64 "" VALUE I64 0 IDENTITY -9223372036854776000 9223372036854776000 /end TYPEDEF_CHARACTERISTIC
/begin TYPEDEF_CHARACTERISTIC test_f32 "" VALUE F32 0 NO_COMPU_METHOD -100000000000000000000000000000000 100000000000000000000000000000000 /end TYPEDEF_CHARACTERISTIC
/begin TYPEDEF_CHARACTERISTIC test_f64 "" VALUE F64 0 NO_COMPU_METHOD -100000000000000000000000000000000 100000000000000000000000000000000 /end TYPEDEF_CHARACTERISTIC
/begin TYPEDEF_CHARACTERISTIC test_i8_array "" VAL_BLK I8 0 IDENTITY -128 127 MATRIX_DIM 4 /end TYPEDEF_CHARACTERISTIC
/begin TYPEDEF_STRUCTURE TestStruct2 "" 48 /begin STRUCTURE_COMPONENT test_bool test_bool 42 /end STRUCTURE_COMPONENT /begin STRUCTURE_COMPONENT test_u8 test_u8 40 /end STRUCTURE_COMPONENT /begin STRUCTURE_COMPONENT test_u16 test_u16 36 /end STRUCTURE_COMPONENT /begin STRUCTURE_COMPONENT test_u32 test_u32 24 /end STRUCTURE_COMPONENT /begin STRUCTURE_COMPONENT test_u64 test_u64 0 /end STRUCTURE_COMPONENT /begin STRUCTURE_COMPONENT test_i8 test_i8 41 /end STRUCTURE_COMPONENT /begin STRUCTURE_COMPONENT test_i16 test_i16 38 /end STRUCTURE_COMPONENT /begin STRUCTURE_COMPONENT test_i32 test_i32 28 /end STRUCTURE_COMPONENT /begin STRUCTURE_COMPONENT test_i64 test_i64 8 /end STRUCTURE_COMPONENT /begin STRUCTURE_COMPONENT test_f32 test_f32 32 /end STRUCTURE_COMPONENT /begin STRUCTURE_COMPONENT test_f64 test_f64 16 /end STRUCTURE_COMPONENT /end TYPEDEF_STRUCTURE
/begin TYPEDEF_STRUCTURE TestStruct1 "" 96 /begin STRUCTURE_COMPONENT test_bool test_bool 94 /end STRUCTURE_COMPONENT /begin STRUCTURE_COMPONENT test_u8 test_u8 92 /end STRUCTURE_COMPONENT /begin STRUCTURE_COMPONENT test_u16 test_u16 88 /end STRUCTURE_COMPONENT /begin STRUCTURE_COMPONENT test_u32 test_u32 72 /end STRUCTURE_COMPONENT /begin STRUCTURE_COMPONENT test_u64 test_u64 0 /end STRUCTURE_COMPONENT /begin STRUCTURE_COMPONENT test_i8 test_i8 93 /end STRUCTURE_COMPONENT /begin STRUCTURE_COMPONENT test_i8_array test_i8_array 76 /end STRUCTURE_COMPONENT /begin STRUCTURE_COMPONENT test_i16 test_i16 90 /end STRUCTURE_COMPONENT /begin STRUCTURE_COMPONENT test_i32 test_i32 80 /end STRUCTURE_COMPONENT /begin STRUCTURE_COMPONENT test_i64 test_i64 8 /end STRUCTURE_COMPONENT /begin STRUCTURE_COMPONENT test_f32 test_f32 84 /end STRUCTURE_COMPONENT /begin STRUCTURE_COMPONENT test_f64 test_f64 16 /end STRUCTURE_COMPONENT /begin STRUCTURE_COMPONENT test_struct TestStruct2 24 /end STRUCTURE_COMPONENT /end TYPEDEF_STRUCTURE
/begin TYPEDEF_CHARACTERISTIC test_array "" VAL_BLK U8 0 IDENTITY 0 255 MATRIX_DIM 8 /end TYPEDEF_CHARACTERISTIC
/begin TYPEDEF_CHARACTERISTIC test_matrix "" VAL_BLK U8 0 IDENTITY 0 255 MATRIX_DIM 8 16 /end TYPEDEF_CHARACTERISTIC
/begin TYPEDEF_STRUCTURE CalPage1 "" 472 /begin STRUCTURE_COMPONENT counter_max counter_max 448 /end STRUCTURE_COMPONENT /begin STRUCTURE_COMPONENT test_bool test_bool 470 /end STRUCTURE_COMPONENT /begin STRUCTURE_COMPONENT test_u8 test_u8 468 /end STRUCTURE_COMPONENT /begin STRUCTURE_COMPONENT test_u16 test_u16 464 /end STRUCTURE_COMPONENT /begin STRUCTURE_COMPONENT test_u32 test_u32 452 /end STRUCTURE_COMPONENT /begin STRUCTURE_COMPONENT test_u64 test_u64 128 /end STRUCTURE_COMPONENT /begin STRUCTURE_COMPONENT test_i8 test_i8 469 /end STRUCTURE_COMPONENT /begin STRUCTURE_COMPONENT test_i16 test_i16 466 /end STRUCTURE_COMPONENT /begin STRUCTURE_COMPONENT test_i32 test_i32 456 /end STRUCTURE_COMPONENT /begin STRUCTURE_COMPONENT test_i64 test_i64 136 /end STRUCTURE_COMPONENT /begin STRUCTURE_COMPONENT test_f32 test_f32 460 /end STRUCTURE_COMPONENT /begin STRUCTURE_COMPONENT test_f64 test_f64 144 /end STRUCTURE_COMPONENT /begin STRUCTURE_COMPONENT test_struct TestStruct1 352 /end STRUCTURE_COMPONENT /begin STRUCTURE_COMPONENT test_array test_array 152 /end STRUCTURE_COMPONENT /begin STRUCTURE_COMPONENT test_matrix test_matrix 0 /end STRUCTURE_COMPONENT /begin STRUCTURE_COMPONENT test_struct_array TestStruct2 160 MATRIX_DIM 4 /end STRUCTURE_COMPONENT /end TYPEDEF_STRUCTURE
/begin TYPEDEF_CHARACTERISTIC ampl "Amplitude" VALUE F64 0 NO_COMPU_METHOD 0 400 PHYS_UNIT "Volt" /end TYPEDEF_CHARACTERISTIC
/begin TYPEDEF_CHARACTERISTIC period "Period" VALUE F64 0 NO_COMPU_METHOD 0 1000 PHYS_UNIT "s" /end TYPEDEF_CHARACTERISTIC
/begin TYPEDEF_CHARACTERISTIC array "Demo array" VAL_BLK F64 0 NO_COMPU_METHOD 0 100 PHYS_UNIT "ms" MATRIX_DIM 16 /end TYPEDEF_CHARACTERISTIC
/begin TYPEDEF_AXIS curve_axis "Demo shared axis for curve1/2" NO_INPUT_QUANTITY A_F32 0 NO_COMPU_METHOD 16 0 100 /end TYPEDEF_AXIS
/begin TYPEDEF_CHARACTERISTIC curve1 "Demo curve" CURVE F64 0 NO_COMPU_METHOD -100 100
 /begin AXIS_DESCR COM_AXIS NO_INPUT_QUANTITY NO_COMPU_METHOD 16 0.0 0.0 AXIS_PTS_REF calseg2.curve_axis /end AXIS_DESCR
/end TYPEDEF_CHARACTERISTIC
/begin TYPEDEF_CHARACTERISTIC curve2 "Demo curve" CURVE F64 0 NO_COMPU_METHOD -100 100
 /begin AXIS_DESCR COM_AXIS NO_INPUT_QUANTITY NO_COMPU_METHOD 16 0.0 0.0 AXIS_PTS_REF calseg2.curve_axis /end AXIS_DESCR
/end TYPEDEF_CHARACTERISTIC
/begin TYPEDEF_AXIS map_x_axis "Demo shared axis for map2" NO_INPUT_QUANTITY A_U16 0 IDENTITY 9 0 1000 /end TYPEDEF_AXIS
/begin TYPEDEF_CHARACTERISTIC map "Demo map" MAP U8 0 IDENTITY 0 100 PHYS_UNIT "ms"
 /begin AXIS_DESCR COM_AXIS NO_INPUT_QUANTITY NO_COMPU_METHOD 9 0.0 0.0 AXIS_PTS_REF calseg2.map_x_axis /end AXIS_DESCR
 /begin AXIS_DESCR FIX_AXIS NO_INPUT_QUANTITY NO_COMPU_METHOD 8 0 7 FIX_AXIS_PAR_DIST 0 1 8 /end AXIS_DESCR
/end TYPEDEF_CHARACTERISTIC
/begin TYPEDEF_STRUCTURE CalPage2 "" 560 /begin STRUCTURE_COMPONENT ampl ampl 448 /end STRUCTURE_COMPONENT /begin STRUCTURE_COMPONENT period period 456 /end STRUCTURE_COMPONENT /begin STRUCTURE_COMPONENT array array 0 /end STRUCTURE_COMPONENT /begin STRUCTURE_COMPONENT curve_axis curve_axis 384 /end STRUCTURE_COMPONENT /begin STRUCTURE_COMPONENT curve1 curve1 128 /end STRUCTURE_COMPONENT /begin STRUCTURE_COMPONENT curve2 curve2 256 /end STRUCTURE_COMPONENT /begin STRUCTURE_COMPONENT map_x_axis map_x_axis 536 /end STRUCTURE_COMPONENT /begin STRUCTURE_COMPONENT map map 464 /end STRUCTURE_COMPONENT /end TYPEDEF_STRUCTURE
/begin TYPEDEF_MEASUREMENT a "" UBYTE IDENTITY 0 0 0 255 /end TYPEDEF_MEASUREMENT
/begin TYPEDEF_MEASUREMENT b "" A_UINT64 IDENTITY 0 0 0 18446744073709552000 /end TYPEDEF_MEASUREMENT
/begin TYPEDEF_MEASUREMENT c "" FLOAT64_IEEE NO_COMPU_METHOD 0 0 -100000000000000000000000000000000 100000000000000000000000000000000 /end TYPEDEF_MEASUREMENT
/begin TYPEDEF_STRUCTURE TestStruct "" 24 /begin STRUCTURE_COMPONENT a a 16 /end STRUCTURE_COMPONENT /begin STRUCTURE_COMPONENT b b 0 /end STRUCTURE_COMPONENT /begin STRUCTURE_COMPONENT c c 8 /end STRUCTURE_COMPONENT /end TYPEDEF_STRUCTURE
/begin TYPEDEF_STRUCTURE TestNestedStruct "" 48 /begin STRUCTURE_COMPONENT s1 TestStruct 0 /end STRUCTURE_COMPONENT /begin STRUCTURE_COMPONENT s2 TestStruct 24 /end STRUCTURE_COMPONENT /end TYPEDEF_STRUCTURE
/* Measurements */
/* Measurements for event 'main' */
/begin MEASUREMENT mainloop_counter1 "" A_UINT64 IDENTITY 0 0 0 18446744073709552000 ECU_ADDRESS 0x280FF5C ECU_ADDRESS_EXTENSION 2 READ_WRITE
 /begin IF_DATA XCP
  /begin DAQ_EVENT FIXED_EVENT_LIST EVENT 10 /end DAQ_EVENT
 /end IF_DATA
/end MEASUREMENT
/begin COMPU_METHOD mainloop_local_var1 "" LINEAR "%.3" "no unit" COEFFS_LINEAR 0.5 10000000 /end COMPU_METHOD
/begin MEASUREMENT mainloop_local_var1 "test local variable with conversion rule" A_UINT64 mainloop_local_var1 0 0 10000000 9223372036864776000 ECU_ADDRESS 0x281005C ECU_ADDRESS_EXTENSION 2 READ_WRITE
 /begin IF_DATA XCP
  /begin DAQ_EVENT FIXED_EVENT_LIST EVENT 10 /end DAQ_EVENT
 /end IF_DATA
/end MEASUREMENT
/begin INSTANCE mainloop_struct "" TestNestedStruct 0x280FF94 ECU_ADDRESS_EXTENSION 2
 /begin IF_DATA XCP
  /begin DAQ_EVENT FIXED_EVENT_LIST EVENT 10 /end DAQ_EVENT
 /end IF_DATA
/end INSTANCE
/begin INSTANCE mainloop_struct1 "" TestStruct 0x280FF64 ECU_ADDRESS_EXTENSION 2
 /begin IF_DATA XCP
  /begin DAQ_EVENT FIXED_EVENT_LIST EVENT 10 /end DAQ_EVENT
 /end IF_DATA
/end INSTANCE
/begin INSTANCE mainloop_struct2 "" TestStruct 0x280FF7C ECU_ADDRESS_EXTENSION 2
 /begin IF_DATA XCP
  /begin DAQ_EVENT FIXED_EVENT_LIST EVENT 10 /end DAQ_EVENT
 /end IF_DATA
/end INSTANCE
/* Measurements for event 'main_local' */
/begin COMPU_METHOD mainloop_local_var2 "" LINEAR "%.0" "no unit" COEFFS_LINEAR 2 -10000000 /end COMPU_METHOD
/begin MEASUREMENT mainloop_local_var2 "test local variable with conversion rule" A_UINT64 mainloop_local_var2 0 0 -10000000 36893488147409105000 ECU_ADDRESS 0x340FFEC ECU_ADDRESS_EXTENSION 2 READ_WRITE
 /begin IF_DATA XCP
  /begin DAQ_EVENT FIXED_EVENT_LIST EVENT 13 /end DAQ_EVENT
 /end IF_DATA
/end MEASUREMENT
/* Measurements for event 'main_task1' */
/begin MEASUREMENT array1 "" FLOAT64_IEEE NO_COMPU_METHOD 0 0 -100000000000000000000000000000000 100000000000000000000000000000000 ECU_ADDRESS 0x300F794 ECU_ADDRESS_EXTENSION 2 READ_WRITE MATRIX_DIM 256
 /begin IF_DATA XCP
  /begin DAQ_EVENT FIXED_EVENT_LIST EVENT 12 /end DAQ_EVENT
 /end IF_DATA
/end MEASUREMENT
/begin MEASUREMENT counter "" ULONG IDENTITY 0 0 0 4294967295 ECU_ADDRESS 0x300F758 ECU_ADDRESS_EXTENSION 2 READ_WRITE
 /begin IF_DATA XCP
  /begin DAQ_EVENT FIXED_EVENT_LIST EVENT 12 /end DAQ_EVENT
 /end IF_DATA
/end MEASUREMENT
/begin MEASUREMENT counter_i16 "counter: i16" SWORD IDENTITY 0 0 -32768 32767 ECU_ADDRESS 0x300F762 ECU_ADDRESS_EXTENSION 2 READ_WRITE
 /begin IF_DATA XCP
  /begin DAQ_EVENT FIXED_EVENT_LIST EVENT 12 /end DAQ_EVENT
 /end IF_DATA
/end MEASUREMENT
/begin MEASUREMENT counter_i32 "counter: i32" SLONG IDENTITY 0 0 -2147483648 2147483647 ECU_ADDRESS 0x300F768 ECU_ADDRESS_EXTENSION 2 READ_WRITE
 /begin IF_DATA XCP
  /begin DAQ_EVENT FIXED_EVENT_LIST EVENT 12 /end DAQ_EVENT
 /end IF_DATA
/end MEASUREMENT
/begin MEASUREMENT counter_i64 "counter: i64" A_INT64 IDENTITY 0 0 -9223372036854776000 9223372036854776000 ECU_ADDRESS 0x300F774 ECU_ADDRESS_EXTENSION 2 READ_WRITE
 /begin IF_DATA XCP
  /begin DAQ_EVENT FIXED_EVENT_LIST EVENT 12 /end DAQ_EVENT
 /end IF_DATA
/end MEASUREMENT
/begin MEASUREMENT counter_i8 "counter: i8" SBYTE IDENTITY 0 0 -128 127 ECU_ADDRESS 0x300F75F ECU_ADDRESS_EXTENSION 2 READ_WRITE
 /begin IF_DATA XCP
  /begin DAQ_EVENT FIXED_EVENT_LIST EVENT 12 /end DAQ_EVENT
 /end IF_DATA
/end MEASUREMENT
/begin MEASUREMENT counter_isize "counter: i64" A_INT64 IDENTITY 0 0 -9223372036854776000 9223372036854776000 ECU_ADDRESS 0x300F784 ECU_ADDRESS_EXTENSION 2 READ_WRITE
 /begin IF_DATA XCP
  /begin DAQ_EVENT FIXED_EVENT_LIST EVENT 12 /end DAQ_EVENT
 /end IF_DATA
/end MEASUREMENT
/begin MEASUREMENT counter_option_u16 "counter optional: u8" UWORD IDENTITY 0 0 0 65535 ECU_ADDRESS 0x300F790 ECU_ADDRESS_EXTENSION 2 READ_WRITE
 /begin IF_DATA XCP
  /begin DAQ_EVENT FIXED_EVENT_LIST EVENT 12 /end DAQ_EVENT
 /end IF_DATA
/end MEASUREMENT
/begin MEASUREMENT counter_u16 "counter: u16" UWORD IDENTITY 0 0 0 65535 ECU_ADDRESS 0x300F760 ECU_ADDRESS_EXTENSION 2 READ_WRITE
 /begin IF_DATA XCP
  /begin DAQ_EVENT FIXED_EVENT_LIST EVENT 12 /end DAQ_EVENT
 /end IF_DATA
/end MEASUREMENT
/begin MEASUREMENT counter_u32 "counter: u32" ULONG IDENTITY 0 0 0 4294967295 ECU_ADDRESS 0x300F764 ECU_ADDRESS_EXTENSION 2 READ_WRITE
 /begin IF_DATA XCP
  /begin DAQ_EVENT FIXED_EVENT_LIST EVENT 12 /end DAQ_EVENT
 /end IF_DATA
/end MEASUREMENT
/begin MEASUREMENT counter_u64 "counter: u64" A_UINT64 IDENTITY 0 0 0 18446744073709552000 ECU_ADDRESS 0x300F76C ECU_ADDRESS_EXTENSION 2 READ_WRITE
 /begin IF_DATA XCP
  /begin DAQ_EVENT FIXED_EVENT_LIST EVENT 12 /end DAQ_EVENT
 /end IF_DATA
/end MEASUREMENT
/begin MEASUREMENT counter_u8 "counter: u8" UBYTE IDENTITY 0 0 0 255 ECU_ADDRESS 0x300F75E ECU_ADDRESS_EXTENSION 2 READ_WRITE
 /begin IF_DATA XCP
  /begin DAQ_EVENT FIXED_EVENT_LIST EVENT 12 /end DAQ_EVENT
 /end IF_DATA
/end MEASUREMENT
/begin MEASUREMENT counter_usize "counter: u64" A_UINT64 IDENTITY 0 0 0 18446744073709552000 ECU_ADDRESS 0x300F77C ECU_ADDRESS_EXTENSION 2 READ_WRITE
 /begin IF_DATA XCP
  /begin DAQ_EVENT FIXED_EVENT_LIST EVENT 12 /end DAQ_EVENT
 /end IF_DATA
/end MEASUREMENT
/begin MEASUREMENT channel_1 "sine: f64" FLOAT64_IEEE NO_COMPU_METHOD 0 0 -100000000000000000000000000000000 100000000000000000000000000000000 ECU_ADDRESS 0x10000 ECU_ADDRESS_EXTENSION 2 READ_WRITE PHYS_UNIT "Volt"
 /begin IF_DATA XCP
  /begin DAQ_EVENT VARIABLE /begin DEFAULT_EVENT_LIST EVENT 0 /end DEFAULT_EVENT_LIST /end DAQ_EVENT
 /end IF_DATA
/end MEASUREMENT
/begin MEASUREMENT channel_2 "sine: f64" FLOAT64_IEEE NO_COMPU_METHOD 0 0 -100000000000000000000000000000000 100000000000000000000000000000000 ECU_ADDRESS 0x810000 ECU_ADDRESS_EXTENSION 2 READ_WRITE PHYS_UNIT "Volt"
 /begin IF_DATA XCP
  /begin DAQ_EVENT FIXED_EVENT_LIST EVENT 2 /end DAQ_EVENT
 /end IF_DATA
/end MEASUREMENT
/begin MEASUREMENT channel_3 "sine: f64" FLOAT64_IEEE NO_COMPU_METHOD 0 0 -100000000000000000000000000000000 100000000000000000000000000000000 ECU_ADDRESS 0xC10000 ECU_ADDRESS_EXTENSION 2 READ_WRITE PHYS_UNIT "Volt"
 /begin IF_DATA XCP
  /begin DAQ_EVENT FIXED_EVENT_LIST EVENT 3 /end DAQ_EVENT
 /end IF_DATA
/end MEASUREMENT
/begin MEASUREMENT channel_4 "sine: f64" FLOAT64_IEEE NO_COMPU_METHOD 0 0 -100000000000000000000000000000000 100000000000000000000000000000000 ECU_ADDRESS 0x1010000 ECU_ADDRESS_EXTENSION 2 READ_WRITE PHYS_UNIT "Volt"
 /begin IF_DATA XCP
  /begin DAQ_EVENT FIXED_EVENT_LIST EVENT 4 /end DAQ_EVENT
 /end IF_DATA
/end MEASUREMENT
/begin MEASUREMENT channel_5 "sine: f64" FLOAT64_IEEE NO_COMPU_METHOD 0 0 -100000000000000000000000000000000 100000000000000000000000000000000 ECU_ADDRESS 0x1410000 ECU_ADDRESS_EXTENSION 2 READ_WRITE PHYS_UNIT "Volt"
 /begin IF_DATA XCP
  /begin DAQ_EVENT FIXED_EVENT_LIST EVENT 5 /end DAQ_EVENT
 /end IF_DATA
/end MEASUREMENT
/begin MEASUREMENT channel_6 "sine: f64" FLOAT64_IEEE NO_COMPU_METHOD 0 0 -100000000000000000000000000000000 100000000000000000000000000000000 ECU_ADDRESS 0x1810000 ECU_ADDRESS_EXTENSION 2 READ_WRITE PHYS_UNIT "Volt"
 /begin IF_DATA XCP
  /begin DAQ_EVENT FIXED_EVENT_LIST EVENT 6 /end DAQ_EVENT
 /end IF_DATA
/end MEASUREMENT
/begin MEASUREMENT channel_7 "sine: f64" FLOAT64_IEEE NO_COMPU_METHOD 0 0 -100000000000000000000000000000000 100000000000000000000000000000000 ECU_ADDRESS 0x1C10000 ECU_ADDRESS_EXTENSION 2 READ_WRITE PHYS_UNIT "Volt"
 /begin IF_DATA XCP
  /begin DAQ_EVENT FIXED_EVENT_LIST EVENT 7 /end DAQ_EVENT
 /end IF_DATA
/end MEASUREMENT
/begin MEASUREMENT channel_8 "sine: f64" FLOAT64_IEEE NO_COMPU_METHOD 0 0 -100000000000000000000000000000000 100000000000000000000000000000000 ECU_ADDRESS 0x2010000 ECU_ADDRESS_EXTENSION 2 READ_WRITE PHYS_UNIT "Volt"
 /begin IF_DATA XCP
  /begin DAQ_EVENT FIXED_EVENT_LIST EVENT 8 /end DAQ_EVENT
 /end IF_DATA
/end MEASUREMENT
/begin MEASUREMENT channel_9 "sine: f64" FLOAT64_IEEE NO_COMPU_METHOD 0 0 -100000000000000000000000000000000 100000000000000000000000000000000 ECU_ADDRESS 0x2410000 ECU_ADDRESS_EXTENSION 2 READ_WRITE PHYS_UNIT "Volt"
 /begin IF_DATA XCP
  /begin DAQ_EVENT FIXED_EVENT_LIST EVENT 9 /end DAQ_EVENT
 /end IF_DATA
/end MEASUREMENT
/begin MEASUREMENT channel_10 "sine: f64" FLOAT64_IEEE NO_COMPU_METHOD 0 0 -100000000000000000000000000000000 100000000000000000000000000000000 ECU_ADDRESS 0x2C10000 ECU_ADDRESS_EXTENSION 2 READ_WRITE PHYS_UNIT "Volt"
 /begin IF_DATA XCP
  /begin DAQ_EVENT FIXED_EVENT_LIST EVENT 11 /end DAQ_EVENT
 /end IF_DATA
/end MEASUREMENT
/* Measurements for event 'main_task2s' */
/begin MEASUREMENT channel "sine: f64" FLOAT64_IEEE NO_COMPU_METHOD 0 0 -100000000000000000000000000000000 100000000000000000000000000000000 ECU_ADDRESS 0x410000 ECU_ADDRESS_EXTENSION 2 READ_WRITE PHYS_UNIT "Volt"
 /begin IF_DATA XCP
  /begin DAQ_EVENT FIXED_EVENT_LIST EVENT 1 /end DAQ_EVENT
 /end IF_DATA
/end MEASUREMENT
/* Measurements without fixed event */
/begin GROUP Measurements "" ROOT /begin SUB_GROUP main main_local main_task1 main_task2 main_task2s /end SUB_GROUP /end GROUP
/begin GROUP main ""
 /begin REF_MEASUREMENT mainloop_counter1 mainloop_local_var1 mainloop_struct mainloop_struct1 mainloop_struct2 /end REF_MEASUREMENT
/end GROUP
/begin GROUP main_local "" /begin REF_MEASUREMENT mainloop_local_var2 /end REF_MEASUREMENT /end GROUP
/begin GROUP main_task1 ""
 /begin REF_MEASUREMENT array1 counter counter_i16 counter_i32 counter_i64 counter_i8 counter_isize counter_option_u16 counter_u16 counter_u32 counter_u64 counter_u8 counter_usize /end REF_MEASUREMENT
/end GROUP
/begin GROUP main_task2 ""
 /begin REF_MEASUREMENT channel_1 channel_2 channel_3 channel_4 channel_5 channel_6 channel_7 channel_8 channel_9 channel_10 /end REF_MEASUREMENT
/end GROUP
/begin GROUP main_task2s "" /begin REF_MEASUREMENT channel /end REF_MEASUREMENT /end GROUP
/* Axis */
/* Characteristics */
/begin INSTANCE calseg "" CalPage 0x80010000 /end INSTANCE
/begin INSTANCE calseg1 "" CalPage1 0x80020000 /end INSTANCE
/begin INSTANCE calseg2 "" CalPage2 0x80030000 /end INSTANCE
/* Characteristic and Axis Groups */
/begin GROUP Characteristics "" ROOT /begin SUB_GROUP calseg calseg1 calseg2 /end SUB_GROUP /end GROUP
/begin GROUP calseg "" /begin REF_CHARACTERISTIC calseg /end REF_CHARACTERISTIC /end GROUP
/begin GROUP calseg1 "" /begin REF_CHARACTERISTIC calseg1 /end REF_CHARACTERISTIC /end GROUP
/begin GROUP calseg2 "" /begin REF_CHARACTERISTIC calseg2 /end REF_CHARACTERISTIC /end GROUP
/end MODULE
/end PROJECT
